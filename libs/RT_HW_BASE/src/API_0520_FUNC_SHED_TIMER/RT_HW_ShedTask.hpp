
//+++++++++++++++++++++++++++++++++++++++++++++++++++++++++++++++++++++++++++++++++++++++++++++++++
//
//                               RT_HW_ShedTask — Sheduler на программных таймерах
//
//   Версия 10 — Расширенная версия с точным оформлением по стилю 09
//
//   ● Вызов задач по интервалу времени (millis())
//   ● Поддержка callback-функций
//   ● Подсчёт и доступ к количеству вызовов loop() в секунду
//   ● Вывод — вне библиотеки, только через внешние задачи
//
//+++++++++++++++++++++++++++++++++++++++++++++++++++++++++++++++++++++++++++++++++++++++++++++++++

#ifndef RT_HW_ShedTask_hpp
#define RT_HW_ShedTask_hpp

#include <Arduino.h>

#ifndef RT_HW_MAX_TASK
  #define RT_HW_MAX_TASK 8    //-- Значение по умолчанию
#endif

//-------------------------------------------------------------------------------------------------
//                                          КЛАСС
//-------------------------------------------------------------------------------------------------
class RT_HW_ShedTask {
  public:

//-------------------------------------------------------------------------------------------------
//                            Тип callback-функции
//-------------------------------------------------------------------------------------------------
    typedef void (*Callback)();  //-- Указатель на функцию без аргументов и возврата

//-------------------------------------------------------------------------------------------------
//                            Конструктор
//-------------------------------------------------------------------------------------------------
    RT_HW_ShedTask() : taskCount(0), loopCounter(0), lastMeterTime(0), loopSpeed(0) {}

//-------------------------------------------------------------------------------------------------
//                            Добавление задачи
//-------------------------------------------------------------------------------------------------
    int add(Callback cb, uint32_t intervalMs) {
      if (taskCount >= RT_HW_MAX_TASK) return -1;
      tasks[taskCount].callback = cb;
      tasks[taskCount].interval = intervalMs;
      tasks[taskCount].lastTime = millis();
      tasks[taskCount].active = true;
      taskCount++;
      return taskCount - 1;
    }

//-------------------------------------------------------------------------------------------------
//                            Основной вызов задач
//-------------------------------------------------------------------------------------------------
    void pool() {
      loopCounter++;
      uint32_t currentTime = millis();

      if (currentTime - lastMeterTime >= 1000) {
        loopSpeed = loopCounter;
        loopCounter = 0;
        lastMeterTime = currentTime;
      }

      for (int i = 0; i < taskCount; i++) {
        if (tasks[i].active && (currentTime - tasks[i].lastTime >= tasks[i].interval)) {
          tasks[i].callback();
          tasks[i].lastTime = currentTime;
        }
      }
    }

//-------------------------------------------------------------------------------------------------
//                            Удаление задачи по индексу
//-------------------------------------------------------------------------------------------------
    void remove(int index) {
      if (index >= 0 && index < taskCount) {
        for (int i = index; i < taskCount - 1; i++) {
          tasks[i] = tasks[i + 1];
        }
        taskCount--;
      }
    }

//-------------------------------------------------------------------------------------------------
//                            Очистка всех задач
//-------------------------------------------------------------------------------------------------
    void clearAll() {
      taskCount = 0;
    }

//-------------------------------------------------------------------------------------------------
//                            Получение количества задач
//-------------------------------------------------------------------------------------------------
    int count() {
      return taskCount;
    }

//-------------------------------------------------------------------------------------------------
//                            Включение задачи
//-------------------------------------------------------------------------------------------------
    void enable(int index) {
      if (index >= 0 && index < taskCount) {
        tasks[index].active = true;
      }
    }

//-------------------------------------------------------------------------------------------------
//                            Отключение задачи
//-------------------------------------------------------------------------------------------------
    void disable(int index) {
      if (index >= 0 && index < taskCount) {
        tasks[index].active = false;
      }
    }

//-------------------------------------------------------------------------------------------------
//                            Проверка активности задачи
//-------------------------------------------------------------------------------------------------
    bool isActive(int index) {
      if (index >= 0 && index < taskCount) {
        return tasks[index].active;
      }
      return false;
    }

//-------------------------------------------------------------------------------------------------
//                            Изменение интервала задачи
//-------------------------------------------------------------------------------------------------
    void setInterval(int index, uint32_t intervalMs) {
      if (index >= 0 && index < taskCount) {
        tasks[index].interval = intervalMs;
      }
    }

//-------------------------------------------------------------------------------------------------
//                            Получение количества вызовов loop() в секунду
//-------------------------------------------------------------------------------------------------
    uint32_t getLoopSpeed() {
      return loopSpeed;
    }

  private:

//-------------------------------------------------------------------------------------------------
//                            ВНУТРЕННЯЯ СТРУКТУРА И ПЕРЕМЕННЫЕ
//-------------------------------------------------------------------------------------------------

    struct Task {
      uint32_t lastTime;     //-- Последнее время выполнения
      uint32_t interval;     //-- Интервал выполнения
      Callback callback;     //-- Указатель на вызываемую функцию
      bool active;           //-- Признак активности задачи
    };

    Task tasks[RT_HW_MAX_TASK];  //-- Массив задач
    int taskCount;               //-- Количество зарегистрированных задач

    uint32_t loopCounter;        //-- Счётчик итераций loop()
    uint32_t lastMeterTime;      //-- Время последнего обновления счётчика
    uint32_t loopSpeed;          //-- Количество вызовов loop() в последнюю секунду
};

//-------------------------------------------------------------------------------------------------
//                                         КОНЕЦ ФАЙЛА
//-------------------------------------------------------------------------------------------------
#endif
