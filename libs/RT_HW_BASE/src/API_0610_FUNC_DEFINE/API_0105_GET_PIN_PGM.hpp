//=================================================================================================
// RT_HW_PGM_END соответствует 254	
//+++++++++++++++++++++++++++++++++++++++++++++++++++++++++++++++++++++++++++++++++++++++++++++++++
//
//									1.ДОСТУП К МАССИВАМ ПИНОВ PROGMEM 						
//									Последний элемент равен RT_HW_PGM_END.
//+++++++++++++++++++++++++++++++++++++++++++++++++++++++++++++++++++++++++++++++++++++++++++++++++  
//=================================================================================================
//					1.1. Получение пина по его индексу
// Функция удобна для доступа к массивам с последовательными значениями типа X0,X1... ,Y0,Y1...
//=================================================================================================
  uint8_t getPinPGM(const uint8_t *arr, uint8_t idx){ 
	(void)arr; (void)idx;
	uint8_t bf8=0;
	for(uint8_t i=0; i<254; i++) {
		bf8=pgm_read_byte(&arr[i]); 
		if(bf8==254){return 255;}			//--Выход=0, если конец массива;
		if(idx==i)  {return bf8;}			//--Успешный выход=1, если обнаружен пин.
	} 
	return 255;
  }; 
//=================================================================================================
//					1.2. Проверка наличия значения пина в массиве.
//=================================================================================================
  uint8_t checkPinPGM(const uint8_t *arr, uint8_t pin){ 
    if(pin==255) {return 0;}
	uint8_t bf8=0;
	for(uint8_t i=0; i<254; i++) {
		bf8=pgm_read_byte(&arr[i]); 
		if(bf8==254){return 0;}			//--Выход=0, если конец массива;
		if(bf8==pin){return 1;}			//--Успешный выход=1, если обнаружен пин.
	} 
	return 0;
  }; 
//=================================================================================================
//					1.3. Получение размера массива без учета значений=255 (пин отсутствует)
//=================================================================================================
  uint8_t getSizePinPGM(const uint8_t *arr){ 
	uint8_t k=0; uint8_t bf=0;  (void)k; (void)bf;
	for(uint8_t i=0; i<255; i++) {
		bf=pgm_read_byte(&arr[i]);
		if(bf==RT_HW_PGM_END){break;} 
		if(bf!=255) {k++;} 
	}	
		return k;
  }; 
//=================================================================================================
//					1.4. Получение полного размера массива
//=================================================================================================
  uint8_t getFullPinPGM(const uint8_t *arr){ 
	uint8_t k=0; uint8_t bf=0;  (void)k; (void)bf;
	for(uint8_t i=0; i<255; i++) {
		bf=pgm_read_byte(&arr[i]);
		if(bf==RT_HW_PGM_END){break;} 		
		k++; 
	}	
		return k;
  };
//=================================================================================================
  