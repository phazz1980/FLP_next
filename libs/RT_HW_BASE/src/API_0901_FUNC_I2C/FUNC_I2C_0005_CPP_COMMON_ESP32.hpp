#include "RT_HW_BASE.h"	 
//+++++++++++++++++++++++++++++++++++++++++++++++++++++++++++++++++++++++++++++++++++++++++++++++++
//
//											ОБЪЕКТЫ I2C ESP32
//
//+++++++++++++++++++++++++++++++++++++++++++++++++++++++++++++++++++++++++++++++++++++++++++++++++
 //=================================================================================================
#if !defined(RT_HW_CREATE_I2C_CODE) && defined(RT_HW_CORE_ESP32)
	#define  RT_HW_CREATE_I2C_CODE 
//=================================================================================================
// 											0. Объекты UART
//=================================================================================================
	#if defined(RT_HW_PERMIT_I2C0)
	   #define RT_HW_PRESENT_I2C0   
	#endif
//-------------------------------------------------------------------------------------------------
	#if defined(RT_HW_PERMIT_I2C1)
	   #define RT_HW_PRESENT_I2C1   
	#endif	
//-------------------------------------------------------------------------------------------------

//=================================================================================================
//+++++++++++++++++++++++++++++++++++++++++++++++++++++++++++++++++++++++++++++++++++++++++++++++++
//
//										1. ФУНКЦИИ НАСТРОЙКИ I2C
//
//+++++++++++++++++++++++++++++++++++++++++++++++++++++++++++++++++++++++++++++++++++++++++++++++++;
//=================================================================================================
//						        		1.1. Инициализация i2cx как MASTER
//=================================================================================================	
  uint8_t  	RT_HW_BASE:: 	i2cBegin(			  uint8_t bus){
	(void)bus;
//-------------------------------------------------------------------------------------------------
	i2cClearCodeErr(bus);										//--Сброс кода ошибки;
	if(!i2cCheckBus(bus))	 {i2cSetCodeErr(65,bus); return 1;}	//--Выход, если недопустимый номер шины;
	if( i2cGetStatus(bus)==1){            			 return 1;} //--Выход, если шина уже Master;
	if(!i2cSetBusy(bus))	 {            			 return 0;}	//--Захват шины или выход еcли шина занята;
    i2cEnd(bus);												//--Отключение шины i2c (если вдруг раньше была инициализирована функцией Wirex.begin();
//-------------------------------------------------------------------------------------------------
//						Проверка подтяжки(Vcc) пинов SDA,SCL (обычно внешние резисторы 10к)
//-------------------------------------------------------------------------------------------------
	uint8_t pin;
	pin=i2cGetPinSDA(bus); if(pin==255) {return 1;} pinMode(pin,INPUT_PULLUP); if(!digitalRead(pin)){i2cSetCodeErr(61,bus); return 1;} 
	pin=i2cGetPinSCL(bus); if(pin==255) {return 1;} pinMode(pin,INPUT_PULLUP); if(!digitalRead(pin)){i2cSetCodeErr(61,bus); return 1;}      
//-------------------------------------------------------------------------------------------------
	#if defined(RT_HW_PRESENT_I2C0)	
		if(bus==0){
			Wire.setPins(i2cGetPinSDA(bus),i2cGetPinSCL(bus));	//--Установка пинов SDA, SCL;	
			Wire.begin();										//--Инициализация шины как Master;
			Wire.setClock(i2cGetSpeed(bus));;					//--Установка скорости;	
			Wire.setTimeOut(50); 								//--Установка тайм-аута на транзакцию;
			i2cSetStatus(1,bus);								//--Установка регистра status=1(Master);			
			i2cClearBusy(bus); 									//--Сброс регистра занятости шины;
		return 1;												//--Успешный выход;
		}
	#endif
//-------------------------------------------------------------------------------------------------
	#if defined(RT_HW_PRESENT_I2C1)	
		if(bus==1){
			Wire1.setPins(i2cGetPinSDA(bus),i2cGetPinSCL(bus));	//--Установка пинов SDA, SCL;	
			Wire1.begin();										//--Инициализация шины как Master;
			Wire1.setClock(i2cGetSpeed(bus));;					//--Установка скорости;	
			Wire1.setTimeOut(50); 								//--Установка тайм-аута на транзакцию;
			i2cSetStatus(1,bus);								//--Установка регистра status=1(Master);			
			i2cClearBusy(bus); 									//--Сброс регистра занятости шины;
		return 1;												//--Успешный выход;
		}
	#endif
//-------------------------------------------------------------------------------------------------
		i2cSetCodeErr(70,bus);									//--Установка кода ошибки "No bus";
		i2cClearBusy(bus); 										//--Сброс регистра занятости шины;;
		return 1;												//--Выход по ошибке;
//-------------------------------------------------------------------------------------------------
  };	//====END	uint8_t  RT_HW_BASE:: i2cBegin(uint8_t bus)
//=================================================================================================
//						        		1.2. Инициализация как Slave  i2cx;
//											(пока заглушка)
//=================================================================================================
  uint8_t  RT_HW_BASE:: 	i2cBeginSlave(uint8_t adr, uint8_t bus){
	(void)adr; (void)bus;
	return 1;	
  };  
//=================================================================================================
// 										1.3. Отключение i2cx
//=================================================================================================
  void		RT_HW_BASE::	i2cEnd(uint8_t bus){
	(void)bus;
//-------------------------------------------------------------------------------------------------
	#if defined(RT_HW_PRESENT_I2C0)		
		if(bus==0){if(i2cGetStatus(bus)==1){i2cSetStatus(0,bus); 	Wire.end();   	return;}}
	#endif	
//-------------------------------------------------------------------------------------------------
	#if defined(RT_HW_PRESENT_I2C1)
		if(bus==1){if(i2cGetStatus(bus)==1){i2cSetStatus(0,bus); 	Wire1.end();  	return;}}
	#endif	
//-------------------------------------------------------------------------------------------------
  };	//===END void RT_HW_BASE:: i2cEnd(uint8_t bus)	
//=================================================================================================
//						 				1.4. Установка clock для шины i2cx (аппаратная скорость);
//=================================================================================================
  void  	RT_HW_BASE:: 	i2cSetClock(uint32_t speed,uint8_t bus){
	(void)speed; (void)bus;
//-------------------------------------------------------------------------------------------------
	if(speed==0){speed=RT_HW_I2C_SPEED;}
//-------------------------------------------------------------------------------------------------	
	#if defined(RT_HW_PRESENT_I2C0) 
		if(bus==0)	{Wire.setClock(speed);    	return;}
	#endif	
//-------------------------------------------------------------------------------------------------	
	#if defined(RT_HW_PRESENT_I2C1) 
		if(bus==1)	{Wire1.setClock(speed);    	return;}
	#endif
//-------------------------------------------------------------------------------------------------	
  };
//=================================================================================================
//										1.5. Установка пинов RX,TX в объект LinkI2Cx;
//=================================================================================================
  void		RT_HW_BASE::	i2cSetPins(uint8_t sda, uint8_t scl, uint8_t bus){
	(void)sda; (void)scl; (void)bus; uint8_t bf; (void)bf;
//-------------------------------------------------------------------------------------------------
	#if defined(RT_HW_PRESENT_I2C0)
		if(bus==0){
			if(sda==scl){i2cSetCodeErr(60,bus); return;}	//--Выход по ошибке если SDA=SCL;
			LinkI2C0.sda=sda; LinkI2C0.scl=scl; 			//--Установкак пинов SDA,SCL;
			return;   										//--Успешный выход;
		}
	#endif
//-------------------------------------------------------------------------------------------------
	#if defined(RT_HW_PRESENT_I2C1)
		if(bus==1){
			if(sda==scl){i2cSetCodeErr(60,bus); return;}	//--Выход по ошибке если SDA=SCL;
			LinkI2C1.sda=sda; LinkI2C1.scl=scl; 			//--Установкак пинов SDA,SCL;
			return;   										//--Успешный выход;
		}
	#endif
//-------------------------------------------------------------------------------------------------
			i2cSetCodeErr(70,bus);							//--Установка кода ошибки "No bus";
			return;											//--Выход по ошибке;
//-------------------------------------------------------------------------------------------------
  };

//+++++++++++++++++++++++++++++++++++++++++++++++++++++++++++++++++++++++++++++++++++++++++++++++++
//
//											2. ФУНКЦИИ ОБМЕНА i2c
//
//+++++++++++++++++++++++++++++++++++++++++++++++++++++++++++++++++++++++++++++++++++++++++++++++++
//=================================================================================================
//									2.1. Начало     транзакции обмена i2cx
//=================================================================================================
  void   	RT_HW_BASE:: 	i2cBeginTransmission(uint8_t adr, uint8_t bus){
	(void)adr; (void)bus;
//-------------------------------------------------------------------------------------------------
		if(i2cGetStatus(bus)!=1){						return;};	//--Выход если шина не Master;
//-------------------------------------------------------------------------------------------------	
	#if defined(RT_HW_PRESENT_I2C0)
		if(bus==0){Wire.beginTransmission(adr); 		return;};
	#endif	
//-------------------------------------------------------------------------------------------------	
	#if defined(RT_HW_PRESENT_I2C1)
		if(bus==1){Wire1.beginTransmission(adr); 		return;};
	#endif			
//-------------------------------------------------------------------------------------------------		
  };
//=================================================================================================
//									2.2. Завершение транзакции обмена i2cx
//=================================================================================================
  uint8_t 	 RT_HW_BASE:: 	i2cEndTransmission(uint8_t bus){
	(void)bus;
//-------------------------------------------------------------------------------------------------
		if(i2cGetStatus(bus)!=1){						return 5;};	//--Выход если шина не Master;
//-------------------------------------------------------------------------------------------------
	#if defined(RT_HW_PRESENT_I2C0)
		if(bus==0){return Wire.endTransmission();};
	#endif	
//-------------------------------------------------------------------------------------------------	
	#if defined(RT_HW_PRESENT_I2C1)
		if(bus==1){return Wire1.endTransmission();};
	#endif	
//-------------------------------------------------------------------------------------------------	
		return 6;
//-------------------------------------------------------------------------------------------------
  };
//=================================================================================================
//									2.3. i2cFlush(bus)
//=================================================================================================
  uint8_t  	RT_HW_BASE:: 	i2cFlush(uint8_t bus){
	(void)bus;
//-------------------------------------------------------------------------------------------------	
	#if defined(RT_HW_PRESENT_I2C0)
		if(bus==0){Wire.flush(); return 1;}
	#endif	
//-------------------------------------------------------------------------------------------------	
	#if defined(RT_HW_PRESENT_I2C1)
		if(bus==1){Wire1.flush(); return 1;}
	#endif		
//-------------------------------------------------------------------------------------------------
		return 0;
//-------------------------------------------------------------------------------------------------	
  };

//=================================================================================================
//									2.3. Запрос на чтение qnt байт в  буфер  i2cx;
//=================================================================================================
  uint8_t  	RT_HW_BASE:: 	i2cRequestFrom(uint8_t qnt,  uint8_t adr, uint8_t bus, uint8_t sendStop){
	(void)bus; (void)qnt; (void)adr; (void)sendStop;
//-------------------------------------------------------------------------------------------------	
	#if defined(RT_HW_PRESENT_I2C0)
		if(bus==0){return Wire.requestFrom(adr,qnt,(uint8_t)sendStop);};
	#endif	
//-------------------------------------------------------------------------------------------------	
	#if defined(RT_HW_PRESENT_I2C1)
		if(bus==1){return Wire1.requestFrom(adr,qnt,(uint8_t)sendStop);};
	#endif		
//-------------------------------------------------------------------------------------------------		
		return 0;
//-------------------------------------------------------------------------------------------------
  };
//=================================================================================================
//									2.4. Проверка количество принятых байт в  буфере i2cx
//=================================================================================================
  uint8_t  	RT_HW_BASE:: 	i2cAvailable(uint8_t bus){
	(void)bus;
//-------------------------------------------------------------------------------------------------	
	#if defined(RT_HW_PRESENT_I2C0)
		if(bus==0){return Wire.available();};
	#endif	
//-------------------------------------------------------------------------------------------------	
	#if defined(RT_HW_PRESENT_I2C1)
		if(bus==1){return Wire1.available();};
	#endif			
//-------------------------------------------------------------------------------------------------				
		return 0;
//-------------------------------------------------------------------------------------------------		
	};
		//=================================================================================================
//									2.5. Чтение байт из буфера i2cx
//=================================================================================================
  uint8_t  	RT_HW_BASE:: 	i2cRead(uint8_t bus){
	(void)bus;
//-------------------------------------------------------------------------------------------------	
	#if defined(RT_HW_PRESENT_I2C0)
		if(bus==0){return Wire.read();};
	#endif	
//-------------------------------------------------------------------------------------------------	
	#if defined(RT_HW_PRESENT_I2C1)
		if(bus==1){return Wire1.read();};
	#endif	
//-------------------------------------------------------------------------------------------------					
		return 0;
//-------------------------------------------------------------------------------------------------	
	};
//=================================================================================================
//									2.6. Запись qnt    байт  в i2cx;
//=================================================================================================
  void  	RT_HW_BASE:: 	i2cWrite(uint8_t v, uint8_t bus){
	(void)v; (void)bus;
//-------------------------------------------------------------------------------------------------	
	#if defined(RT_HW_PRESENT_I2C0)
		if(bus==0){Wire.write(v); 		return;};
	#endif	
//-------------------------------------------------------------------------------------------------	
	#if defined(RT_HW_PRESENT_I2C1)
		if(bus==1){Wire1.write(v); 		return;};
	#endif		
//-------------------------------------------------------------------------------------------------		
  };
//=================================================================================================
//									2.7. Запись qnt байт в i2cx
//=================================================================================================
  void     	RT_HW_BASE:: 	i2cWrite(const uint8_t *arr, uint8_t qnt, uint8_t bus){	
	(void)arr; (void)qnt;  (void)bus;
//-------------------------------------------------------------------------------------------------
		if(qnt>32){qnt=32;} 
		for(uint8_t i=0; i<qnt; i++){i2cWrite(arr[i],bus);}
	};	
//=================================================================================================
//									2.8. Запись qnt символов в i2cx
//=================================================================================================
  void   	RT_HW_BASE:: 	i2cWrite(const char    *arr, uint8_t qnt, uint8_t bus){	
	(void)arr; (void)qnt;  (void)bus;
//-------------------------------------------------------------------------------------------------
		if(qnt>32){qnt=32;} 
		for(uint8_t i=0; i<qnt; i++){i2cWrite(arr[i],bus);}
  };	
//=================================================================================================

//+++++++++++++++++++++++++++++++++++++++++++++++++++++++++++++++++++++++++++++++++++++++++++++++++
#endif		//====END #if !defined(RT_HW_CREATE_I2C_CODE) && defined(RT_HW_CORE_ESP32)
//+++++++++++++++++++++++++++++++++++++++++++++++++++++++++++++++++++++++++++++++++++++++++++++++++

