#include "RT_HW_BASE.h"	 
//+++++++++++++++++++++++++++++++++++++++++++++++++++++++++++++++++++++++++++++++++++++++++++++++++
//
//											ОБЪЕКТЫ I2C RP2040
//
//+++++++++++++++++++++++++++++++++++++++++++++++++++++++++++++++++++++++++++++++++++++++++++++++++
 //=================================================================================================
#if !defined(RT_HW_CREATE_I2C_CODE) && defined(RT_HW_CORE_RP2040)
	#define  RT_HW_CREATE_I2C_CODE 		
//=================================================================================================
// 											2. Объекты UART
//=================================================================================================
	#if defined(RT_HW_PERMIT_I2C0)
	   #define RT_HW_PRESENT_I2C0   
		RT_HW_STRUCT_I2C LinkI2C0; 
	#endif
//-------------------------------------------------------------------------------------------------
	#if defined(RT_HW_PERMIT_I2C1)
	   #define RT_HW_PRESENT_I2C1   
		RT_HW_STRUCT_I2C LinkI2C1; 
	#endif	
//-------------------------------------------------------------------------------------------------

//=================================================================================================
//+++++++++++++++++++++++++++++++++++++++++++++++++++++++++++++++++++++++++++++++++++++++++++++++++
//
//										1. ФУНКЦИИ НАСТРОЙКИ I2C
//
//+++++++++++++++++++++++++++++++++++++++++++++++++++++++++++++++++++++++++++++++++++++++++++++++++
//=================================================================================================
//						        		1.1. Инициализация i2cx как MASTER
//=================================================================================================	
  uint8_t  	RT_HW_BASE:: 	i2cBegin(			  uint8_t bus){
	(void)bus;
//-------------------------------------------------------------------------------------------------
	i2cClearCodeErr(bus);										//--Сброс кода ошибки;
	if(!i2cCheckBus(bus))	 {i2cSetCodeErr(65,bus); return 1;}	//--Выход, если недопустимый номер шины;
	if( i2cGetStatus(bus)==1){            			 return 1;} //--Выход, если шина уже Master;
	if(!i2cSetBusy(bus))	 {            			 return 0;}	//--Захват шины или выход еcли шина занята;
    i2cEnd(bus);												//--Отключение шины i2c (если вдруг раньше была инициализирована функцией Wirex.begin();
//-------------------------------------------------------------------------------------------------
//						Проверка подтяжки(Vcc) пинов SDA,SCL (обычно внешние резисторы 10к)
//-------------------------------------------------------------------------------------------------
	uint8_t pin;
	pin=i2cGetPinSDA(bus); pinMode(pin,INPUT_PULLUP); if(!digitalRead(pin)){i2cSetCodeErr(61,bus); return 1;};  
	pin=i2cGetPinSCL(bus); pinMode(pin,INPUT_PULLUP); if(!digitalRead(pin)){i2cSetCodeErr(62,bus); return 1;};   
//-------------------------------------------------------------------------------------------------
	#if defined(RT_HW_PRESENT_I2C0)	
		if(bus==0){
			Wire.setSDA(i2cGetPinSDA(bus));						//--Установка пина SDA;	
			Wire.setSCL(i2cGetPinSCL(bus));						//--Установка пина SCL;			
			Wire.begin();										//--Инициализация шины как Master;
			Wire.setClock(i2cGetSpeed(bus));;					//--Установка скорости;	
			i2cSetStatus(1,bus);								//--Установка регистра status=1(Master);
			i2cClearBusy(bus);									//--Сброс регистра занятости шины; 
			return 1;												//--Успешный выход;
		}
	#endif
//-------------------------------------------------------------------------------------------------
	#if defined(RT_HW_PRESENT_I2C1)	
		if(bus==1){
			Wire1.setSDA(i2cGetPinSDA(bus));					//--Установка пина SDA;	
			Wire1.setSCL(i2cGetPinSCL(bus));					//--Установка пина SCL;	
			Wire1.begin();										//--Инициализация шины как Master;
			Wire1.setClock(i2cGetSpeed(bus));;					//--Установка скорости;	
			i2cSetStatus(1,bus);								//--Установка регистра status=1(Master);			
			i2cClearBusy(bus); 									//--Сброс регистра занятости шины;
		return 1;												//--Успешный выход;
		}
	#endif
//-------------------------------------------------------------------------------------------------
		i2cSetCodeErr(70,bus);									//--Установка кода ошибки "No bus";
		i2cClearBusy(bus); 										//--Сброс регистра занятости шины;;
		return 1;												//--Выход по ошибке;
//-------------------------------------------------------------------------------------------------
  };	//====END	uint8_t  RT_HW_BASE:: i2cBegin(uint8_t bus)
//=================================================================================================
//						        		1.2. Инициализация как Slave  i2cx;
//											(пока заглушка)
//=================================================================================================
  uint8_t  RT_HW_BASE:: 	i2cBeginSlave(uint8_t adr, uint8_t bus){
	(void)adr; (void)bus;
	return 1;	
  }; 
//=================================================================================================
// 										1.3. Отключение i2cx
//=================================================================================================
  void		RT_HW_BASE::	i2cEnd(uint8_t bus){
	(void)bus;
//-------------------------------------------------------------------------------------------------
	#if defined(RT_HW_PRESENT_I2C0)		
		if(bus==0){if(i2cGetStatus(bus)==1){i2cSetStatus(0,bus); 	Wire.end();   	return;}}
	#endif	
//-------------------------------------------------------------------------------------------------
	#if defined(RT_HW_PRESENT_I2C1)
		if(bus==1){if(i2cGetStatus(bus)==1){i2cSetStatus(0,bus); 	Wire1.end();  	return;}}
	#endif	
//-------------------------------------------------------------------------------------------------
  };	//===END void RT_HW_BASE:: i2cEnd(uint8_t bus)	
//=================================================================================================
//										1.4. Установка пинов RX,TX в объект LinkI2Cx;
//=================================================================================================
  void		RT_HW_BASE::	i2cSetPins(uint8_t sda, uint8_t scl, uint8_t bus){
	(void)sda; (void)scl; (void)bus; uint8_t bf; (void)bf;
//-------------------------------------------------------------------------------------------------
	#if defined(RT_HW_PRESENT_I2C0)	
//------Wire (SDA,SCL): 0,1; 4,5;  8, 9; 12,13; 16,17; 20,21, 28,29;
		if(bus==0){
			LinkI2C0.busy=LinkI2C0.status=LinkI2C0.codeErr=0;	//--Очистка регистров;
			uint8_t bf=1;
			if(!bf){if((sda== 0) && (scl== 1)){bf=1;}}
			if(!bf){if((sda== 4) && (scl== 5)){bf=1;}}
			if(!bf){if((sda== 8) && (scl== 9)){bf=1;}}
			if(!bf){if((sda==12) && (scl==13)){bf=1;}}
			if(!bf){if((sda==16) && (scl==17)){bf=1;}}
			if(!bf){if((sda==20) && (scl==21)){bf=1;}}
			if(!bf){if((sda==28) && (scl==29)){bf=1;}}
			if( bf){LinkI2C0.sda=sda; LinkI2C0.scl=scl; return;} 	//--Set pins SDA,SCL bus=0;			
			return;
		}
	#endif
//-------------------------------------------------------------------------------------------------
	#if defined(RT_HW_PRESENT_I2C1)
//------Wire1(SDA,SCL): 2,3; 6,7; 10,11; 14,15; 18,19; 26,27;
		if(bus==1){
			LinkI2C1.busy=LinkI2C1.status=LinkI2C1.codeErr=0;	//--Очистка регистров;
			uint8_t bf=1;			
			if(!bf){if((sda== 2) && (scl== 3)){bf=1;}}
			if(!bf){if((sda== 6) && (scl== 7)){bf=1;}}
			if(!bf){if((sda==10) && (scl==11)){bf=1;}}
			if(!bf){if((sda==14) && (scl==15)){bf=1;}}
			if(!bf){if((sda==18) && (scl==19)){bf=1;}}
			if(!bf){if((sda==26) && (scl==27)){bf=1;}}
			if( bf){LinkI2C1.sda=sda; LinkI2C1.scl=scl; return;} 	//--Set pins SDA,SCL bus=1;
			return;  
		}
	#endif
//-------------------------------------------------------------------------------------------------
			i2cSetCodeErr(70,bus);							//--Установка кода ошибки "No bus";
			return;											//--Выход по ошибке;
//-------------------------------------------------------------------------------------------------
  };
/*
//=================================================================================================
// 										1.5. Получение пина SDA из объекта LinkI2Cx;
//=================================================================================================
  uint8_t 	RT_HW_BASE::	i2cGetPinSDA(uint8_t bus){
	(void)bus;
//-------------------------------------------------------------------------------------------------
	#if defined(RT_HW_PRESENT_I2C0)	
		if(bus==0) {return LinkI2C0.sda;}
	#endif
//-------------------------------------------------------------------------------------------------	
	#if defined(RT_HW_PRESENT_I2C1)	
		if(bus==1) {return LinkI2C1.sda;}
	#endif
//-------------------------------------------------------------------------------------------------	
		return 255;
//-------------------------------------------------------------------------------------------------
};
//=================================================================================================
// 										1.6. Получение пина SCL из объекта LinkI2Cx;
//=================================================================================================
  uint8_t 	RT_HW_BASE::	i2cGetPinSCL(uint8_t bus){
	(void)bus;
//-------------------------------------------------------------------------------------------------
	#if defined(RT_HW_PRESENT_I2C0)	
		if(bus==0) {return LinkI2C0.scl;}
	#endif
//-------------------------------------------------------------------------------------------------	
	#if defined(RT_HW_PRESENT_I2C1)	
		if(bus==1) {return LinkI2C1.scl;}
	#endif
//-------------------------------------------------------------------------------------------------	
		return 255;
//-------------------------------------------------------------------------------------------------
  };
*/  
//=================================================================================================
//						 				1.7. Установка clock для шины i2cx (аппаратная скорость);
//=================================================================================================
  void  	RT_HW_BASE:: 	i2cSetClock(uint32_t speed,uint8_t bus){
	(void)speed; (void)bus;
//-------------------------------------------------------------------------------------------------
	if(speed==0){speed=RT_HW_I2C_SPEED;}
//-------------------------------------------------------------------------------------------------	
	#if defined(RT_HW_PRESENT_I2C0) 
		if(bus==0)	{Wire.setClock(speed);    	return;}
	#endif	
//-------------------------------------------------------------------------------------------------	
	#if defined(RT_HW_PRESENT_I2C1) 
		if(bus==1)	{Wire1.setClock(speed);    	return;}
	#endif
//-------------------------------------------------------------------------------------------------	
  };

/*
//=================================================================================================
// 		    				1.8. Инициализация параметров (и пинов) по умолчанию для i2cx
//=================================================================================================
  void  	RT_HW_BASE::	i2cInitParam (uint8_t bus){						
//-------------------------------------------------------------------------------------------------
	#if defined(RT_HW_PRESENT_I2C0)							
		if(bus==0){
			LinkI2C0.busy=LinkI2C0.status=LinkI2C0.codeErr=0;	//--Очистка регистров;
			LinkI2C0.sda =RT_HW_I2C0_SDA;						//--Установка пина SDA; 
			LinkI2C0.scl =RT_HW_I2C0_SCL;						//--Установка пина SCL; 
			LinkI2C0.speed=RT_HW_I2C_SPEED;            	    	//--Установка скорости;
			return;
		}
	#endif 
//-------------------------------------------------------------------------------------------------
	#if defined(RT_HW_PRESENT_I2C1)							
		if(bus==1){
			LinkI2C1.busy=LinkI2C1.status=LinkI2C1.codeErr=0;	//--Очистка регистров;
			LinkI2C1.sda =RT_HW_I2C1_SDA;						//--Установка пина SDA; 
			LinkI2C1.scl =RT_HW_I2C1_SCL;						//--Установка пина SCL; 
			LinkI2C1.speed=RT_HW_I2C_SPEED;            	    	//--Установка скорости;
			return;
		}
	#endif
//-------------------------------------------------------------------------------------------------
  };
//=================================================================================================
//						    		1.9. Инициализация параметров (и пинов) по умолчанию для всех i2c
//=================================================================================================
  void    	RT_HW_BASE::	i2cInitParamAll(){
		for(uint8_t i=0; i<4; i++){i2cInitParam(i);}
  }; 
*/
//+++++++++++++++++++++++++++++++++++++++++++++++++++++++++++++++++++++++++++++++++++++++++++++++++
//
//											2. ФУНКЦИИ ОБМЕНА i2c
//
//+++++++++++++++++++++++++++++++++++++++++++++++++++++++++++++++++++++++++++++++++++++++++++++++++
//=================================================================================================
//									2.1. Начало     транзакции обмена i2cx
//=================================================================================================
  void   	RT_HW_BASE:: 	i2cBeginTransmission(uint8_t adr, uint8_t bus){
	(void)adr; (void)bus;
//-------------------------------------------------------------------------------------------------
		if(i2cGetStatus(bus)!=1){						return;};	//--Выход если шина не Master;
//-------------------------------------------------------------------------------------------------	
	#if defined(RT_HW_PRESENT_I2C0)
		if(bus==0){Wire.beginTransmission(adr); 		return;};
	#endif	
//-------------------------------------------------------------------------------------------------	
	#if defined(RT_HW_PRESENT_I2C1)
		if(bus==1){Wire1.beginTransmission(adr); 		return;};
	#endif			
//-------------------------------------------------------------------------------------------------		
  };
//=================================================================================================
//									2.2. Завершение транзакции обмена i2cx
//=================================================================================================
  uint8_t 	 RT_HW_BASE:: 	i2cEndTransmission(uint8_t bus){
	(void)bus;
//-------------------------------------------------------------------------------------------------
		if(i2cGetStatus(bus)!=1){						return 5;};	//--Выход если шина не Master;
//-------------------------------------------------------------------------------------------------
	#if defined(RT_HW_PRESENT_I2C0)
		if(bus==0){return Wire.endTransmission();};
	#endif	
//-------------------------------------------------------------------------------------------------	
	#if defined(RT_HW_PRESENT_I2C1)
		if(bus==1){return Wire1.endTransmission();};
	#endif	
//-------------------------------------------------------------------------------------------------	
		return 6;
//-------------------------------------------------------------------------------------------------
  };
//=================================================================================================
//									2.3. i2cFlush(bus)
//=================================================================================================
  uint8_t  	RT_HW_BASE:: 	i2cFlush(uint8_t bus){
	(void)bus;
//-------------------------------------------------------------------------------------------------	
	#if defined(RT_HW_PRESENT_I2C0)
		if(bus==0){Wire.flush(); return 1;}
	#endif	
//-------------------------------------------------------------------------------------------------	
	#if defined(RT_HW_PRESENT_I2C1)
		if(bus==1){Wire1.flush(); return 1;}
	#endif		
//-------------------------------------------------------------------------------------------------
		return 0;
//-------------------------------------------------------------------------------------------------	
  };

//=================================================================================================
//									2.3. Запрос на чтение qnt байт в  буфер  i2cx;
//=================================================================================================
  uint8_t  	RT_HW_BASE:: 	i2cRequestFrom(uint8_t qnt,  uint8_t adr, uint8_t bus, uint8_t sendStop){
	(void)bus; (void)qnt; (void)adr; (void)sendStop;
//-------------------------------------------------------------------------------------------------	
	#if defined(RT_HW_PRESENT_I2C0)
		if(bus==0){return Wire.requestFrom(adr,qnt,(uint8_t)sendStop);};
	#endif	
//-------------------------------------------------------------------------------------------------	
	#if defined(RT_HW_PRESENT_I2C1)
		if(bus==1){return Wire1.requestFrom(adr,qnt,(uint8_t)sendStop);};
	#endif		
//-------------------------------------------------------------------------------------------------		
		return 0;
//-------------------------------------------------------------------------------------------------
  };
//=================================================================================================
//									2.4. Проверка количество принятых байт в  буфере i2cx
//=================================================================================================
  uint8_t  	RT_HW_BASE:: 	i2cAvailable(uint8_t bus){
	(void)bus;
//-------------------------------------------------------------------------------------------------	
	#if defined(RT_HW_PRESENT_I2C0)
		if(bus==0){return Wire.available();};
	#endif	
//-------------------------------------------------------------------------------------------------	
	#if defined(RT_HW_PRESENT_I2C1)
		if(bus==1){return Wire1.available();};
	#endif			
//-------------------------------------------------------------------------------------------------				
		return 0;
//-------------------------------------------------------------------------------------------------		
	};
		//=================================================================================================
//									2.5. Чтение байт из буфера i2cx
//=================================================================================================
  uint8_t  	RT_HW_BASE:: 	i2cRead(uint8_t bus){
	(void)bus;
//-------------------------------------------------------------------------------------------------	
	#if defined(RT_HW_PRESENT_I2C0)
		if(bus==0){return Wire.read();};
	#endif	
//-------------------------------------------------------------------------------------------------	
	#if defined(RT_HW_PRESENT_I2C1)
		if(bus==1){return Wire1.read();};
	#endif	
//-------------------------------------------------------------------------------------------------					
		return 0;
//-------------------------------------------------------------------------------------------------	
	};
//=================================================================================================
//									2.6. Запись qnt    байт  в i2cx;
//=================================================================================================
  void  	RT_HW_BASE:: 	i2cWrite(uint8_t v, uint8_t bus){
	(void)v; (void)bus;
//-------------------------------------------------------------------------------------------------	
	#if defined(RT_HW_PRESENT_I2C0)
		if(bus==0){Wire.write(v); 		return;};
	#endif	
//-------------------------------------------------------------------------------------------------	
	#if defined(RT_HW_PRESENT_I2C1)
		if(bus==1){Wire1.write(v); 		return;};
	#endif		
//-------------------------------------------------------------------------------------------------		
  };
//=================================================================================================
//									2.7. Запись qnt байт в i2cx
//=================================================================================================
  void     	RT_HW_BASE:: 	i2cWrite(const uint8_t *arr, uint8_t qnt, uint8_t bus){	
	(void)arr; (void)qnt;  (void)bus;
//-------------------------------------------------------------------------------------------------
		if(qnt>32){qnt=32;} 
		for(uint8_t i=0; i<qnt; i++){i2cWrite(arr[i],bus);}
	};	
//=================================================================================================
//									2.8. Запись qnt символов в i2cx
//=================================================================================================
  void   	RT_HW_BASE:: 	i2cWrite(const char    *arr, uint8_t qnt, uint8_t bus){	
	(void)arr; (void)qnt;  (void)bus;
//-------------------------------------------------------------------------------------------------
		if(qnt>32){qnt=32;} 
		for(uint8_t i=0; i<qnt; i++){i2cWrite(arr[i],bus);}
  };	
//=================================================================================================

//+++++++++++++++++++++++++++++++++++++++++++++++++++++++++++++++++++++++++++++++++++++++++++++++++
#endif		//====END #if !defined(RT_HW_CREATE_I2C_CODE) && defined(RT_HW_CORE_ESP32)
//+++++++++++++++++++++++++++++++++++++++++++++++++++++++++++++++++++++++++++++++++++++++++++++++++

