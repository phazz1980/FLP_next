#include "RT_HW_BASE.h"	 
//+++++++++++++++++++++++++++++++++++++++++++++++++++++++++++++++++++++++++++++++++++++++++++++++++
//
//										1. УТИЛИТЫ
//
//+++++++++++++++++++++++++++++++++++++++++++++++++++++++++++++++++++++++++++++++++++++++++++++++++
//=================================================================================================
// 		    						1.1.1. Установка параметров комммуникации 
//								(default параметры: num=0; speed=RT_HW_UART_SPEED)
//=================================================================================================
  uint8_t     RT_HW_BASE:: 	i2cSetParam(RT_HW_STRUCT_I2C_DEV &id){
	if(id.custom==0){
		id.link=id.status=id.codeErr=0; 
		id.custom=1;
	}
	return id.custom;		
  };
//=================================================================================================
// 		    						1.1.2. Установка параметров
//=================================================================================================
  uint8_t	RT_HW_BASE::	i2cSetParam  (RT_HW_STRUCT_I2C_DEV &id, uint8_t addr, uint8_t bus, uint32_t speed){
	(void)addr; (void)bus; (void)speed;
		if(id.custom==0){
			id.link=id.status=id.codeErr=id.err=0; 
			id.addr=addr; 
			id.bus=bus; 
			id.speed=speed; id.custom=1;
		}
	return id.custom;	
  }; 
//=================================================================================================
// 		    						1.1.3. Установка параметров
//=================================================================================================  
   uint8_t	RT_HW_BASE::	i2cSetParam	(RT_HW_STRUCT_I2C_DEV &id, uint8_t addr, uint8_t bus,   uint32_t speed, uint8_t expander, uint8_t channel){
		id.expander=expander; 
		id.channel=channel;	
		return i2cSetParam(id,addr,bus,speed);
   };									
//=================================================================================================
// 		    						1.2. Инициализация устройства как Master
//=================================================================================================
  void		RT_HW_BASE::	i2cInitDevice(RT_HW_STRUCT_I2C_DEV &id){
	id.link=0;
	if(id.custom==0){id.codeErr=50; id.link=1; return;} //--Выход по ошибке =50, если параметры устройство не настроено;
	if(id.status==1){id.codeErr=0;  id.link=1; return;}	//--Успешный выход,	если шина настроена как Master;
	if(id.err==1)   {id.codeErr=51; id.link=1; return;}
	id.status=id.codeErr=0;
//------------------------------------------------------------------------------------------------
	if(!i2cCheckBus(id.bus))	{id.codeErr=52; id.err=1; id.link=1; 	return;}	//--Проверка допустимости номера шины i2c;
    if(!i2cBegin(id.bus))		{				             			return;}	//--Инициализация 	   шины i2c как Master;								  
	if( i2cGetStatus(id.bus)!=1){id.codeErr=53; id.err=1; id.link=1; 	return;}	//--Проверка настройки шины i2c как Master;
//-------------------------------------------------------------------------------------------------
	if(id.speed==0){id.speed=RT_HW_I2C_SPEED;}			//--Установка значения скорости шины по умолчанию;
	id.status=i2cGetStatus(id.bus); 					//--Установка состояния настройки устройства =Master;		
	id.link=1;											//--Установка флага link (успешное завершение);
  };	
//=================================================================================================
// 		    						1.3. Утилита: начальные действия функции обмена 
//									   с устройствами i2c (RT_HW_STRUCT_I2C_DEV &id)
//=================================================================================================
  uint8_t	RT_HW_BASE::	i2cBeginFunc (RT_HW_STRUCT_I2C_DEV &id){
	id.link=0;											//--Очистка флага link(флаг успешного завершения обмена);
	if(i2cGetStatus(id.bus)!=1) {id.link=1; return 1;}	//--Выход если шина i2c не настроена как Master;
	if(i2cSetBusy  (id.bus)==0) {           return 1;}	//--Захват шины i2c;
	i2cSetClock(id.speed,id.bus);						//--Установка скорости шины для обмена с утройством;
	i2cSetChannel(id);									//--При подключении устройства через расширитель i2c, настройка расширителя;
	return 0;												//--Выход успешный;										
  } ;
//=================================================================================================
// 		    						1.4. Утилита: завершающие действия функции обмена 
//									   с устройствами i2c (RT_HW_STRUCT_I2C_DEV &id)
//=================================================================================================
  void		RT_HW_BASE::	i2cEndFunc   (RT_HW_STRUCT_I2C_DEV &id){
	i2cClearChannel(id);								//--Сброс расширителя i2c;	
	i2cSetClock(i2cGetSpeed(id.bus),id.bus);			//--Установка значения скорости шины по умолчанию;
	i2cClearBusy(id.bus); 								//--Освобождение шины i2c;	
	id.link=1;											//--Установка флага link (успешное завершение);
  };
//=================================================================================================
// 		    						1.5. Поиск устройства на шине i2c 
//=================================================================================================
  void		RT_HW_BASE::	i2cFindAddr (RT_HW_STRUCT_I2C_DEV &id){ 
	if(i2cBeginFunc(id)){return;}					//--Проверка готовности, настройка и захват шины, настройка расширителя i2c;
//-------------------------------------------------------------------------------------------------
	i2cBeginTransmission(id); 						//--Начальная   транзакция для обмена с устройством;
	i2cEndTransmission(id);							//--Завершающая транзакция для обмена с устройством;
//-------------------------------------------------------------------------------------------------
	i2cEndFunc(id);									//--Освобождение шины i2c, сброс расширителя i2c;
  };

  
//================================================================================================
// 		    						1.6. Поиск устройства на шине i2c 
//  При ошибке поиска адреса выполняется 6-ть повторов:                                                                                                                                                                                                                                                                                                 
//		первые    три повтора с периодом(ms) 100+(periodFind*id.cntErr);
//		следующие три повтора с периодом(ms) 2000ms;
//		на выходе id.ok>1 (id.ok=id.codeErr);
//	Успешный поиск выполняется qntFind раз c периодом periodFind - на выходе id.ok=1;
//		В процессе поиска адреса id.ok=1.
//=================================================================================================
 void RT_HW_BASE:: i2cFindAddr (RT_HW_STRUCT_I2C_DEV &id, uint8_t qnt, uint8_t period){ 
	if(id.step==0)  {id.ok=id.cnt=0; id.err=id.cntErr=id.codeErr=0; 	id.step=10;}	//--Инициализация параметров;
//-------------------------------------------------------------------------------------------------	
	if(id.step==200){if(!getIsTimerMs(id.timeBegin,id.period)){return;} id.step=10;}	//--Программная задержка;
	//---------------------------------------------------------------------------------------------
	if(id.step==10){
		//--------------------------- Транзакция с адресом устройства -----------------------------
		if(!id.link)		{return;}			//--Выход, если линия	не готова;	
		if(i2cBeginFunc(id)){return;}			//--Проверка готовности, настройка и захват шины, настройка расширителя i2c;
		i2cBeginTransmission(id); 				//--Начальная   транзакция для обмена с устройством;
		i2cEndTransmission(id);					//--Завершающая транзакция для обмена с устройством;
		i2cEndFunc(id);							//--Освобождение шины i2c, сброс расширителя i2c;					
		id.step=200;	id.timeBegin=millis();	//--Подготовка параметров для программной задержки; 		
		//--------------------------- Обработка при ошибке транзакции -----------------------------
		if(id.codeErr){
			id.ok=0; id.cnt=0;  	 
			if(id.cntErr>=3){id.err=1; id.codeErr=21; id.period=2000;	return;}
			id.period=50+(200*id.cntErr++); 							return;	
		}
		//---------------------------- Обработка при успешной транзакции --------------------------
			id.err=0; id.cntErr=0; id.codeErr=0; 
			if(++id.cnt>=qnt)	{id.ok=1; id.step=0;    return;}	//--Успешное завершение;
			id.period=period;	
			return;		//--Переход на повторение доступности адреса:
	}
//-------------------------------------------------------------------------------------------------				
}; 
//+++++++++++++++++++++++++++++++++++++++++++++++++++++++++++++++++++++++++++++++++++++++++++++++++
//
//										2. НАСТРОЙКА ПАРАМЕТРОВ
//
//+++++++++++++++++++++++++++++++++++++++++++++++++++++++++++++++++++++++++++++++++++++++++++++++++ 
 //================================================================================================
// 		    						2.1. Начало     транзакции обмена с устройством i2cx
//=================================================================================================
  void		RT_HW_BASE::	i2cBeginTransmission(RT_HW_STRUCT_I2C_DEV &id){
							i2cBeginTransmission(id.addr,id.bus);
  };
//=================================================================================================
// 		    						2.2. Завершение транзакции обмена с устройством i2cx;
//=================================================================================================
  void		RT_HW_BASE::	i2cEndTransmission(RT_HW_STRUCT_I2C_DEV &id){
				 id.codeErr=i2cEndTransmission(id.bus);
  };
//=================================================================================================
// 		    						2.3. Подключение устройства через расширитель шины i2c(TCA9584A)
//										(если устройство подключено через расширитель)
//=================================================================================================
  void  	RT_HW_BASE::	i2cSetChannel(RT_HW_STRUCT_I2C_DEV &id){
	if(id.expander){									//--Проверка на наличие расширителя;
		if((id.channel>0) && (id.channel<=8)){			//--Проверка на допустимость номера канала;
			uint8_t bf=0; 								//--Создание временной переменной;
			bitSet(bf,(id.channel-1));					//--Установка в переменной бита соответствующего номера канала;
			i2cBeginTransmission(id.expander,id.bus);	//--Начальная   транзакция для обмена с расширителем;
			i2cWrite(bf,id.bus);						//--Запись регистра управления каналами;
			i2cEndTransmission(id.bus);					//--Завершающая транзакция для обмена с расширителем;
			//delayMicroseconds(10);
		}
	}
  };
//=================================================================================================
// 		    						2.4. Отключение устройства через расширитель шины i2c(TCA9584A)
//										(если устройство подключено через расширитель)
//=================================================================================================
  void  	RT_HW_BASE::	i2cClearChannel(RT_HW_STRUCT_I2C_DEV &id){
	if(id.expander){								//--Проверка на наличие расширителя;
        i2cBeginTransmission(id.expander,id.bus);	//--Начальная   транзакция для обмена с расширителем;
        i2cWrite((uint8_t)0,id.bus);							//--Очистка регистра управления каналами;
        i2cEndTransmission(id.bus);					//--Завершающая транзакция для обмена с расширителем;
		//delayMicroseconds(10);	
	}
  };
//+++++++++++++++++++++++++++++++++++++++++++++++++++++++++++++++++++++++++++++++++++++++++++++++++
//
//										3. ЧТЕНИЕ ИЗ УСТРОЙСТВА
//
//+++++++++++++++++++++++++++++++++++++++++++++++++++++++++++++++++++++++++++++++++++++++++++++++++ 
//=================================================================================================
// 		    		3.1. Утилита: Запрос и чтение в буфер i2c qnt байт c тайм-аутом
//=================================================================================================
  void		RT_HW_BASE:: 	i2cRequestFromFunc(RT_HW_STRUCT_I2C_DEV &id, uint16_t qnt){
	uint8_t cnt=i2cRequestFrom(qnt, id.addr, id.bus, id.stop);//--Запрос qnt bytes;
	if(cnt!=qnt){id.codeErr=5; return;}					//--Ошибка =5, если кол-во возвращаемых байт не равно кол-ву запрошенных байт;
	uint32_t timeBegin=micros();
	uint32_t timeEnd;
	uint16_t time=100*qnt;
	do{													//--Ожидание (в цикле с тайм аутом) прихода в буфер i2c qnt запрощенных байт;
		cnt=i2cAvailable(id.bus);						//--Ожидание (в цикле с тайм аутом) прихода в буфер i2c qnt запрощенных байт;
		timeEnd=micros();								//--Фиксация текущего времени для контроля тайм-аута;
		if(cnt>=qnt){break;}							//--Проверка заполнения буфера чтения qnt байтами;
		if(timeEnd>=timeBegin){if((timeEnd   - timeBegin)>time) {id.codeErr=6; return;}}
		else                  {if((timeBegin - timeEnd)  >time) {id.codeErr=6; return;}}
    }
	while(1);    										//--Ожидание завершения цикла do{};				  
														//--Выход успешный;	
};
//=================================================================================================
// 		    						3.2. Чтение байта в id.bf8
//=================================================================================================
  void  	RT_HW_BASE::	i2cRead(RT_HW_STRUCT_I2C_DEV &id){ 
	if(i2cBeginFunc(id)){return;}					//--Проверка готовности, настройка и захват шины, настройка расширителя i2c;
	i2cRequestFromFunc(id, 1);						//--Запрос и прием в буфер qnt байтов;
	if(id.codeErr==0){id.bf8=i2cRead(id.bus);}		//--Чтение qnt байт в массив arr из буфера i2c;	
	i2cEndFunc(id);									//--Освобождение шины i2c, сброс расширителя i2c;
  };
//=================================================================================================
// 		    						3.3. Чтение qnt байт в массив arr
//=================================================================================================
  void   	RT_HW_BASE::	i2cReadArr(RT_HW_STRUCT_I2C_DEV &id, uint8_t *arr, uint16_t qnt){ 
	if(qnt>32) {qnt=32;};							//--Нормализация параметра qnt;
	if(i2cBeginFunc(id)){return;}					//--Проверка готовности, настройка и захват шины, настройка расширителя i2c;
	i2cRequestFromFunc(id, qnt);					//--Запрос и прием в буфер qnt байтов;
	if(id.codeErr==0){								//--Чтение 
		for(uint8_t i=0; i<qnt; i++){				//     qnt байт				
			arr[i]=i2cRead(id.bus);					// 			в массив arr из буфера i2c;	
		}
	}	
	i2cEndFunc(id);									//--Освобождение шины i2c, сброс расширителя i2c;
  };
//=================================================================================================
// 		    						3.4. Чтение из регистра reg байта в id.bf8
//=================================================================================================
  void  	RT_HW_BASE::	i2cReadRegVar(RT_HW_STRUCT_I2C_DEV &id, uint8_t reg){
	if(i2cBeginFunc(id)){return;}						//--Проверка готовности, настройка и захват шины, настройка расширителя i2c;
	i2cBeginTransmission(id); 						//--Начальная   транзакция для обмена с устройством;	
	i2cWrite(reg,id.bus); 							//--Отправка регистра;
	i2cEndTransmission(id);							//--Завершающая транзакция для обмена с устройством;
//------------------------------------------------------------------------------------------------  
	if(id.codeErr==0){i2cRequestFromFunc(id,1);}	//--Запрос и прием в буфер qnt байтов;
	if(id.codeErr==0){id.bf8=i2cRead(id.bus);}		//--Чтение qnt байт в массив arr из буфера i2c;	
//------------------------------------------------------------------------------------------------
	i2cEndFunc(id);									//--Освобождение шины i2c, сброс расширителя i2c;		
  };
//=================================================================================================
// 		    						3.4.1. Чтение из регистра reg байта в id.bf8 (для совместимости со старыми программами)
//=================================================================================================
  void  	RT_HW_BASE::	i2cREAD(RT_HW_STRUCT_I2C_DEV &id, uint8_t reg){i2cReadRegVar(id,reg);};
//=================================================================================================
// 		    						3.5. Чтение начиная с регистра reg  qnt байт в массив arr
//=================================================================================================
  void   	RT_HW_BASE::	i2cReadRegArr(RT_HW_STRUCT_I2C_DEV &id, uint8_t reg, uint8_t *arr, uint16_t qnt){
	if(qnt>32) {qnt=32;};								//--Нормализация параметра qnt;
//-------------------------------------------------------------------------------------------------
	if(i2cBeginFunc(id)){return;}						//--Проверка готовности, настройка и захват шины, настройка расширителя i2c;
//-------------------------------------------------------------------------------------------------
	i2cBeginTransmission(id); 						//--Начальная   транзакция для обмена с устройством;	
	i2cWrite(reg,id.bus); 							//--Отправка регистра;
	i2cEndTransmission(id);							//--Завершающая транзакция для обмена с устройством;
//------------------------------------------------------------------------------------------------  
	if(id.codeErr==0){i2cRequestFromFunc(id, qnt);}	//--Запрос и прием в буфер qnt байтов;
	if(id.codeErr==0){for(uint8_t i=0; i<qnt; i++){arr[i]=i2cRead(id.bus);}}//--Чтение qnt байт в массив arr из буфера i2c;	
//-------------------------------------------------------------------------------------------------
	i2cEndFunc(id);		
  };
//=================================================================================================
// 		    						3.5.1. Чтение из регистра reg байта в id.bf8 (для совместимости со старыми программами)
//=================================================================================================
  void  	RT_HW_BASE::	i2cREADArr(RT_HW_STRUCT_I2C_DEV &id, uint8_t reg, uint8_t *arr, uint16_t qnt){i2cReadRegArr(id,reg,arr,qnt);};

//+++++++++++++++++++++++++++++++++++++++++++++++++++++++++++++++++++++++++++++++++++++++++++++++++
//
//                          			4. ЗАПИСЬ В УСТРОЙСТВО i2c
//
//+++++++++++++++++++++++++++++++++++++++++++++++++++++++++++++++++++++++++++++++++++++++++++++++++
//=================================================================================================
// 		    								4.1. Запись байта
//=================================================================================================
  void  	RT_HW_BASE::	i2cWrite      (RT_HW_STRUCT_I2C_DEV &id, uint8_t var){
	if(i2cBeginFunc(id)){return;}					//--Проверка готовности, настройка и захват шины, настройка расширителя i2c;	
	i2cBeginTransmission(id); 						//--Начальная   транзакция для обмена с устройством;
	i2cWrite(var,id.bus); 							//--Отправка байта;
	i2cEndTransmission(id);							//--Завершающая транзакция для обмена с устройством;
	i2cEndFunc(id);									//--Освобождение шины i2c, сброс расширителя i2c;
  };
//=================================================================================================
// 		    								4.2. Запись двух байт
//=================================================================================================
  void  	RT_HW_BASE::	i2cWrite2    (RT_HW_STRUCT_I2C_DEV &id, uint8_t var1, uint8_t var2){
	if(i2cBeginFunc(id)){return;}						//--Проверка готовности, настройка и захват шины, настройка расширителя i2c;	
	i2cBeginTransmission(id); 						//--Начальная   транзакция для обмена с устройством;
	i2cWrite(var1,id.bus); 							//--Отправка 1-го байта;
	i2cWrite(var2,id.bus); 							//--Отправка 2-го байта; 
	i2cEndTransmission(id);							//--Завершающая транзакция для обмена с устройством;
	i2cEndFunc(id);									//--Освобождение шины i2c, сброс расширителя i2c;
  };

//=================================================================================================
// 		    								4.3. Запись в регистр reg одного байта
//=================================================================================================
  void  	RT_HW_BASE::	i2cWriteReg  (RT_HW_STRUCT_I2C_DEV &id, uint8_t reg, uint8_t var){
	if(i2cBeginFunc(id)){return;}					//--Проверка готовности, настройка и захват шины, настройка расширителя i2c;
	i2cBeginTransmission(id); 						//--Начальная   транзакция для обмена с устройством;
	i2cWrite(reg,id.bus); 							//--Отправка регистра;
	i2cWrite(var,id.bus); 							//--Отправка байта;
	i2cEndTransmission(id);							//--Завершающая транзакция для обмена с устройством;
	i2cEndFunc(id);									//--Освобождение шины i2c, сброс расширителя i2c;
  };
//=================================================================================================
// 		    								4.4. Запись с регистр reg  двух байт
//=================================================================================================
  void  	RT_HW_BASE::	i2cWriteReg2 (RT_HW_STRUCT_I2C_DEV &id, uint8_t reg, uint8_t var1, uint8_t var2){
	if(i2cBeginFunc(id)){return;}					//--Проверка готовности, настройка и захват шины, настройка расширителя i2c;
	i2cBeginTransmission(id); 						//--Начальная   транзакция для обмена с устройством;
	i2cWrite(reg,id.bus); 							//--Отправка регистра;
	i2cWrite(var1,id.bus); 							//--Отправка 1-го байта;
	i2cWrite(var2,id.bus); 							//--Отправка 2-го байта;
	i2cEndTransmission(id);							//--Завершающая транзакция для обмена с устройством;
	i2cEndFunc(id);									//--Освобождение шины i2c, сброс расширителя i2c;
   };
//=================================================================================================
// 		    								4.5. Cлова uint16_t
//=================================================================================================
  void  	RT_HW_BASE::	i2cWriteV16  (RT_HW_STRUCT_I2C_DEV &id, uint16_t var){
	if(i2cBeginFunc(id)){return;}					//--Проверка готовности, настройка и захват шины, настройка расширителя i2c;	
	i2cBeginTransmission(id); 						//--Начальная   транзакция для обмена с устройством;
	i2cWrite((( uint8_t) var&0xFF),     id.bus); 	//--Отправка младшего байта;
	i2cWrite((((uint8_t)(var>>8))&0xFF),id.bus); 	//--Отправка старшего байта; 
	i2cEndTransmission(id);							//--Завершающая транзакция для обмена с устройством;
	i2cEndFunc(id);									//--Освобождение шины i2c, сброс расширителя i2c;
  };
//=================================================================================================
// 		    								4.6. Запись в регистр reg  слова uint16_t
//=================================================================================================
  void  	RT_HW_BASE::	i2cWriteRegV16(RT_HW_STRUCT_I2C_DEV &id, uint8_t reg, uint16_t var){
	if(i2cBeginFunc(id)){return;}					//--Проверка готовности, настройка и захват шины, настройка расширителя i2c;
	i2cBeginTransmission(id); 						//--Начальная   транзакция для обмена с устройством;
	i2cWrite(reg,id.bus); 							//--Отправка регистра;
	i2cWrite((( uint8_t) var&0xFF),     id.bus); 	//--Отправка младшего байта;
	i2cWrite((((uint8_t)(var>>8))&0xFF),id.bus); 	//--Отправка старшего байта;  
	i2cEndTransmission(id);							//--Завершающая транзакция для обмена с устройством;
	i2cEndFunc(id);									//--Освобождение шины i2c, сброс расширителя i2c;
  };
//=================================================================================================
// 		    								4.7. Запись массива из qnt байт
//=================================================================================================
  void  	RT_HW_BASE::	i2cWriteArr(RT_HW_STRUCT_I2C_DEV &id, uint8_t *arr, uint16_t qnt){
	if(qnt>32) {qnt=32;};							//--Нормализация параметра qnt;
	if(i2cBeginFunc(id)){return;}					//--Проверка готовности, настройка и захват шины, настройка расширителя i2c;
	i2cBeginTransmission(id); 						//--Начальная   транзакция для обмена с устройством;
	for(uint8_t i=0; i<qnt; i++){i2cWrite(arr[i],id.bus);} //--Отправка qnt байтoв;
	i2cEndTransmission(id);							//--Завершающая транзакция для обмена с устройством;
	i2cEndFunc(id);									//--Освобождение шины i2c, сброс расширителя i2c;
  };
//=================================================================================================
// 		    								4.8. Запись с регистра reg массива из qnt байт
//=================================================================================================
  void  	RT_HW_BASE::	i2cWriteRegArr(RT_HW_STRUCT_I2C_DEV &id, uint8_t reg, uint8_t *arr, uint16_t qnt){
	if(qnt>32) {qnt=32;};							//--Нормализация параметра qnt;
	if(i2cBeginFunc(id)){return;}					//--Проверка готовности, настройка и захват шины, настройка расширителя i2c;
	i2cBeginTransmission(id); 						//--Начальная   транзакция для обмена с устройством;
	i2cWrite(reg,id.bus); 							//--Отправка регистра;
	for(uint8_t i=0; i<qnt; i++){i2cWrite(arr[i],id.bus);} //--Отправка qnt байтoв;
	i2cEndTransmission(id);							//--Завершающая транзакция для обмена с устройством;
	i2cEndFunc(id);									//--Освобождение шины i2c, сброс расширителя i2c;
  };
//=================================================================================================





