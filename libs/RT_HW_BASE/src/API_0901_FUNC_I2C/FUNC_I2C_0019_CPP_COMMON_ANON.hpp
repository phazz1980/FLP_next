#include "RT_HW_BASE.h"	 
//+++++++++++++++++++++++++++++++++++++++++++++++++++++++++++++++++++++++++++++++++++++++++++++++++
//
//											ОБЪЕКТЫ I2C ANON
//
//+++++++++++++++++++++++++++++++++++++++++++++++++++++++++++++++++++++++++++++++++++++++++++++++++
 //=================================================================================================
#if !defined(RT_HW_CREATE_I2C_CODE)
	#define  RT_HW_CREATE_I2C_CODE 		     
//--------------------------------------------------------------------------------------------------
	#if defined(RT_HW_PERMIT_I2C0)
	   #define RT_HW_PRESENT_I2C0   
		RT_HW_STRUCT_I2C 					 LinkI2C0; 
	#endif
//=================================================================================================
//+++++++++++++++++++++++++++++++++++++++++++++++++++++++++++++++++++++++++++++++++++++++++++++++++
//
//										1. ФУНКЦИИ НАСТРОЙКИ I2C
//
//+++++++++++++++++++++++++++++++++++++++++++++++++++++++++++++++++++++++++++++++++++++++++++++++++
//=================================================================================================
//						        		1.1. Инициализация i2cx как MASTER
//=================================================================================================	
  uint8_t  	RT_HW_BASE:: 	i2cBegin(			  uint8_t bus){
	(void)bus;
//-------------------------------------------------------------------------------------------------
	i2cClearCodeErr(bus);										//--Сброс кода ошибки;
	if(!i2cCheckBus(bus))	 {i2cSetCodeErr(65,bus); return 1;}	//--Выход, если недопустимый номер шины;
	if( i2cGetStatus(bus)==1){            			 return 1;} //--Выход, если шина уже Master;
	if(!i2cSetBusy(bus))	 {            			 return 0;}	//--Захват шины или выход еcли шина занята;
    i2cEnd(bus);												//--Отключение шины i2c (если вдруг раньше была инициализирована функцией Wirex.begin();
//-------------------------------------------------------------------------------------------------
//						Проверка подтяжки(Vcc) пинов SDA,SCL (обычно внешние резисторы 10к)
//-------------------------------------------------------------------------------------------------
	uint8_t pin;
	pin=i2cGetPinSDA(bus); if(pin==255) {return 1;} pinMode(pin,INPUT_PULLUP); if(!digitalRead(pin)){i2cSetCodeErr(61,bus); return 1;} 
	pin=i2cGetPinSCL(bus); if(pin==255) {return 1;} pinMode(pin,INPUT_PULLUP); if(!digitalRead(pin)){i2cSetCodeErr(61,bus); return 1;}  
//-------------------------------------------------------------------------------------------------
	#if defined(RT_HW_PRESENT_I2C0)	
		if(bus==0){		
			Wire.begin();										//--Инициализация шины как Master;
			Wire.setClock(i2cGetSpeed(bus));					//--Установка скорости;	
			i2cSetStatus(1,bus);								//--Установка регистра status=1(Master);
			i2cClearBusy(bus); 									//--Сброс регистра занятости шины;
		return 1;												//--Успешный выход;
		}
	#endif													//--Выход по ошибке;
//-------------------------------------------------------------------------------------------------
		return 0;
//-------------------------------------------------------------------------------------------------  
  };	//====END	uint8_t  RT_HW_BASE:: i2cBegin(uint8_t bus)
//=================================================================================================
//						        	1.2. Инициализация как Slave  i2cx;
//											(пока заглушка)
//=================================================================================================
  uint8_t  	RT_HW_BASE:: 	i2cBeginSlave(uint8_t adr, uint8_t bus){
	(void)adr; (void)bus;
		return 1;	
  };
//=================================================================================================
// 									1.3. Отключение i2cx
//=================================================================================================
  void		RT_HW_BASE::	i2cEnd(uint8_t bus){
	(void)bus;
		return;
//-------------------------------------------------------------------------------------------------
  };	//===END void RT_HW_BASE:: i2cEnd(uint8_t bus)	
//=================================================================================================
//						 		1.4. Установка clock для шины i2cx (аппаратная скорость);
//=================================================================================================
  void  	RT_HW_BASE:: 	i2cSetClock(uint32_t speed,uint8_t bus){
	(void)speed; (void)bus;
//-------------------------------------------------------------------------------------------------
	if(speed==0){speed=RT_HW_I2C_SPEED;}
//-------------------------------------------------------------------------------------------------	
	#if defined(RT_HW_PRESENT_I2C0) 
		if(bus==0)	{Wire.setClock(speed);    	return;}
	#endif	
//-------------------------------------------------------------------------------------------------	
  };
//=================================================================================================
//								1.5. Установка пинов RX,TX в объект LinkI2Cx;
//=================================================================================================
  void		RT_HW_BASE::	i2cSetPins(uint8_t sda, uint8_t scl, uint8_t bus){
	(void)sda; (void)scl; (void)bus; uint8_t bf; (void)bf;
//-------------------------------------------------------------------------------------------------
	#if defined(RT_HW_PRESENT_I2C0)
		if(bus==0){
			if(sda==scl){i2cSetCodeErr(60,bus); return;}	//--Выход по ошибке если SDA=SCL;
			LinkI2C0.sda=sda; LinkI2C0.scl=scl; 			//--Установкак пинов SDA,SCL;
			return;   										//--Успешный выход;
		}
	#endif
//-------------------------------------------------------------------------------------------------
			i2cSetCodeErr(70,bus);							//--Установка кода ошибки "No bus";
			return;											//--Выход по ошибке;
//-------------------------------------------------------------------------------------------------
  };



//+++++++++++++++++++++++++++++++++++++++++++++++++++++++++++++++++++++++++++++++++++++++++++++++++
//
//											2. ФУНКЦИИ ОБМЕНА i2c
//
//+++++++++++++++++++++++++++++++++++++++++++++++++++++++++++++++++++++++++++++++++++++++++++++++++
//=================================================================================================
//									2.1. Начало     транзакции обмена i2cx
//=================================================================================================
  void   	RT_HW_BASE:: 	i2cBeginTransmission(uint8_t adr, uint8_t bus){
	(void)adr; (void)bus;
//-------------------------------------------------------------------------------------------------
		if(i2cGetStatus(bus)!=1){						return;};	//--Выход если шина не Master;
//-------------------------------------------------------------------------------------------------	
	#if defined(RT_HW_PRESENT_I2C0)
		if(bus==0){Wire.beginTransmission(adr); 		return;};
	#endif					
//-------------------------------------------------------------------------------------------------		
  };
//=================================================================================================
//									2.2. Завершение транзакции обмена i2cx
//=================================================================================================
  uint8_t 	 RT_HW_BASE:: 	i2cEndTransmission(uint8_t bus){
	(void)bus;
//-------------------------------------------------------------------------------------------------
		if(i2cGetStatus(bus)!=1){						return 5;};	//--Выход если шина не Master;
//-------------------------------------------------------------------------------------------------
	#if defined(RT_HW_PRESENT_I2C0)
		if(bus==0){return Wire.endTransmission();};
	#endif			
//-------------------------------------------------------------------------------------------------	
		return 6;
//-------------------------------------------------------------------------------------------------
  };
//=================================================================================================
//									2.3. i2cFlush(bus)
//=================================================================================================
  uint8_t  	RT_HW_BASE:: 	i2cFlush(uint8_t bus){
	(void)bus;
//-------------------------------------------------------------------------------------------------	
	#if defined(RT_HW_PRESENT_I2C0)
		if(bus==0){Wire.flush(); return 1;}
	#endif				
//-------------------------------------------------------------------------------------------------
		return 0;
//-------------------------------------------------------------------------------------------------	
  };

//=================================================================================================
//									2.3. Запрос на чтение qnt байт в  буфер  i2cx;
//=================================================================================================
  uint8_t  	RT_HW_BASE:: 	i2cRequestFrom(uint8_t qnt,  uint8_t adr, uint8_t bus, uint8_t sendStop){
	(void)bus; (void)qnt; (void)adr; (void)sendStop;
//-------------------------------------------------------------------------------------------------	
	#if defined(RT_HW_PRESENT_I2C0)
		if(bus==0){return Wire.requestFrom(adr,qnt,(uint8_t)sendStop);};
	#endif			
//-------------------------------------------------------------------------------------------------		
		return 0;
//-------------------------------------------------------------------------------------------------
  };
//=================================================================================================
//									2.4. Проверка количество принятых байт в  буфере i2cx
//=================================================================================================
  uint8_t  	RT_HW_BASE:: 	i2cAvailable(uint8_t bus){
	(void)bus;
//-------------------------------------------------------------------------------------------------	
	#if defined(RT_HW_PRESENT_I2C0)
		if(bus==0){return Wire.available();};
	#endif			
//-------------------------------------------------------------------------------------------------				
		return 0;
//-------------------------------------------------------------------------------------------------		
	};
//=================================================================================================
//									2.5. Чтение байт из буфера i2cx
//=================================================================================================
  uint8_t  	RT_HW_BASE:: 	i2cRead(uint8_t bus){
	(void)bus;
//-------------------------------------------------------------------------------------------------	
	#if defined(RT_HW_PRESENT_I2C0)
		if(bus==0){return Wire.read();};
	#endif				
//-------------------------------------------------------------------------------------------------					
		return 0;
//-------------------------------------------------------------------------------------------------	
	};
//=================================================================================================
//									2.6. Запись qnt    байт  в i2cx;
//=================================================================================================
  void  	RT_HW_BASE:: 	i2cWrite(uint8_t v, uint8_t bus){
	(void)v; (void)bus;
//-------------------------------------------------------------------------------------------------	
	#if defined(RT_HW_PRESENT_I2C0)
		if(bus==0){Wire.write(v); 		return;};
	#endif				
//-------------------------------------------------------------------------------------------------		
  };
//=================================================================================================
//									2.7. Запись qnt байт в i2cx
//=================================================================================================
  void     	RT_HW_BASE:: 	i2cWrite(const uint8_t *arr, uint8_t qnt, uint8_t bus){	
	(void)arr; (void)qnt;  (void)bus;
//-------------------------------------------------------------------------------------------------
		if(qnt>32){qnt=32;} 
		for(uint8_t i=0; i<qnt; i++){i2cWrite(arr[i],bus);}
	};	
//=================================================================================================
//									2.8. Запись qnt символов в i2cx
//=================================================================================================
  void   	RT_HW_BASE:: 	i2cWrite(const char    *arr, uint8_t qnt, uint8_t bus){	
	(void)arr; (void)qnt;  (void)bus;
//-------------------------------------------------------------------------------------------------
		if(qnt>32){qnt=32;} 
		for(uint8_t i=0; i<qnt; i++){i2cWrite(arr[i],bus);}
  };
//=================================================================================================

//+++++++++++++++++++++++++++++++++++++++++++++++++++++++++++++++++++++++++++++++++++++++++++++++++
#endif		//====END #if !defined(RT_HW_CREATE_I2C_CODE) && defined(RT_HW_CORE_STM32)
//+++++++++++++++++++++++++++++++++++++++++++++++++++++++++++++++++++++++++++++++++++++++++++++++++

