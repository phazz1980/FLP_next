//+++++++++++++++++++++++++++++++++++++++++++++++++++++++++++++++++++++++++++++++++++++++++++++++++
//
//											ОБЪЕКТЫ SPI SAM3X
//
//+++++++++++++++++++++++++++++++++++++++++++++++++++++++++++++++++++++++++++++++++++++++++++++++++
#if !defined(RT_HW_CREATE_UART_CODE) && defined(RT_HW_CORE_SAM3X)
	#define  RT_HW_CREATE_UART_CODE  
//=================================================================================================
// 											0. Объекты UART
//=================================================================================================
	#if defined(RT_HW_PERMIT_SPI0)
       #define RT_HW_PRESENT_SPI0    
	#endif  
//=================================================================================================

//+++++++++++++++++++++++++++++++++++++++++++++++++++++++++++++++++++++++++++++++++++++++++++++++++
//										1.БАЗОВЫЕ ФУНКЦИИ SPI
//+++++++++++++++++++++++++++++++++++++++++++++++++++++++++++++++++++++++++++++++++++++++++++++++++
//=================================================================================================
//										1.1. Инициализации шины
//=================================================================================================
  uint8_t  	RT_HW_BASE:: 	spiBegin(uint8_t bus){
	  (void)bus;
//-------------------------------------------------------------------------------------------------
	#if defined(RT_HW_PRESENT_SPI0)	
	 if(bus==0){
			LinkSPI0.codeErr=0;						//--Сброс кода ошибок;
	    if( LinkSPI0.status==1)	 {return 1;} 		//--Выход, если шина уже Master;
		if(!spiSetBusy(bus))	 {return 0;}		//--Захват шины или выход еcли шина занята;
		    SPI.end();								//--Отключение шины SPI (если была инициал. SPIx.begin());
			SPI.begin(); 							//--Инициализация SPI;
						LinkSPI0.status=1;  		//--Установка статуса как Master;
						LinkSPI0.busy=0; 			//--Освобождение шины;
		return 1;
	}	
	#endif
//-------------------------------------------------------------------------------------------------
	return 0;
};	
//=================================================================================================
//										1.2. Отключение шины
//					ПРОВЕРИТЬ: SPI.end()!!!
//=================================================================================================
  void		RT_HW_BASE::	spiEnd (uint8_t bus){
	(void)bus;
//-------------------------------------------------------------------------------------------------
	#if defined(RT_HW_PRESENT_SPI0)	
//		if(bus==0) {SPI.end(); 		return;}
	#endif
//-------------------------------------------------------------------------------------------------
  };
//=================================================================================================
//										1.3. Начало транзакции
//=================================================================================================
  void 		RT_HW_BASE:: 	spiBeginTransaction(uint32_t speed, uint8_t bitOrder, uint8_t dataMode, uint8_t bus){
	(void)speed; (void)bitOrder; (void)dataMode; (void)bus;
//-------------------------------------------------------------------------------------------------
	#if defined(RT_HW_PRESENT_SPI0)	
		if(bus==0) {if(bitOrder){SPI.beginTransaction (SPISettings(speed,MSBFIRST,dataMode));}	
		else                    {SPI.beginTransaction (SPISettings(speed,LSBFIRST,dataMode));}
		return;
		}						 
	#endif
//-------------------------------------------------------------------------------------------------
  };
//=================================================================================================
//										1.4. Завершение транзакции
//=================================================================================================
  void		RT_HW_BASE::	spiEndTransaction  (uint8_t bus){
	(void)bus;
//-------------------------------------------------------------------------------------------------
	#if defined(RT_HW_PRESENT_SPI0)	
		if(bus==0)   		 {SPI.endTransaction(); 	return;}
	#endif
//-------------------------------------------------------------------------------------------------
  };	

//=================================================================================================
//										1.5. Отправка байта tx, возвращает принятый байт
//=================================================================================================
  uint8_t  	RT_HW_BASE:: 	spiTransfer   (uint8_t  tx, uint8_t bus){
	(void)tx; (void)bus;
//-------------------------------------------------------------------------------------------------
	#if defined(RT_HW_PRESENT_SPI0)	
		if(bus==0)    {return SPI.transfer(tx);}
	#endif
//-------------------------------------------------------------------------------------------------
	return 0;
  }; 
//=================================================================================================
//										1.6. Отправка байта tx, прием байта в rx
//=================================================================================================
  void  	RT_HW_BASE:: 	spiTransferVar(uint8_t  tx, uint8_t &rx, uint8_t bus){
	(void)tx; (void)rx; (void)bus;
//-------------------------------------------------------------------------------------------------
	#if defined(RT_HW_PRESENT_SPI0)	
		if(bus==0)        {rx=SPI.transfer(tx); return;}
	#endif
//-------------------------------------------------------------------------------------------------
  };   
//=================================================================================================
//										1.7. Отправка qnt байт из arr[], 
//												прием qnt байт в  arr[]
//=================================================================================================
  void  	RT_HW_BASE:: 	spiTransferArr(uint8_t qnt, uint8_t *arr, uint8_t bus){
	(void)qnt; (void)arr; (void)bus; uint8_t b; (void)b;
	for(uint8_t i=0; i<qnt; i++){
	b=arr[i];	arr[i]=spiTransfer (b,bus);
	}
  };   
//=================================================================================================
//										1.8. Отправка qnt байт из tx[], 
//												прием qnt байт в  rx[]
//=================================================================================================
  void  	RT_HW_BASE:: 	spiTransferArr(uint8_t qnt, uint8_t *tx, uint8_t *rx, uint8_t bus){
	(void)qnt; (void)tx; (void)rx; (void)bus; 
	for(uint8_t i=0; i<qnt; i++){
		rx[i]=spiTransfer(tx[i],bus);
	}
  };   
//=================================================================================================
//										1.9.Установка sck,miso,mosi
//=================================================================================================
  void  	RT_HW_BASE:: 	spiSetPins(uint8_t sck, uint8_t miso, uint8_t mosi, uint8_t bus){ 
	(void)sck; (void)miso; (void)mosi; (void)bus; uint8_t bf; (void)bf;
//-------------------------------------------------------------------------------------------------
	#if defined(RT_HW_PRESENT_SPI0)	
	 if(bus==0){
						LinkSPI0.sck=sck;			//--Сохранение пина sck;
						LinkSPI0.miso=miso;			//--Сохранение пина miso;
						LinkSPI0.mosi=mosi;			//--Сохранение пина mosi;
			SPI.begin(); 							//--Инициализация SPI;
						LinkSPI0.status=1;  		//--Установка статуса как Master;
						LinkSPI0.busy=0; 			//--Освобождение шины;
		return;
	}	
	#endif
//-------------------------------------------------------------------------------------------------
  };  
//=================================================================================================  
//+++++++++++++++++++++++++++++++++++++++++++++++++++++++++++++++++++++++++++++++++++++++++++++++++
#endif		//====END #if !defined(RT_HW_CREATE_SPI_CODE) && defined(RT_HW_CORE_SAM3X)
//+++++++++++++++++++++++++++++++++++++++++++++++++++++++++++++++++++++++++++++++++++++++++++++++++
