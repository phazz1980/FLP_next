	 //+++++++++++++++++++++++++++++++++++++++++++++++++++++++++++++++++++++++++++++++++++++++++++++++++
//
//											ОБЪЕКТЫ SPI ESP32
//
//+++++++++++++++++++++++++++++++++++++++++++++++++++++++++++++++++++++++++++++++++++++++++++++++++
#if !defined(RT_HW_CREATE_SPI_CODE) && defined(RT_HW_CORE_ESP32)
	#define  RT_HW_CREATE_SPI_CODE  
//=================================================================================================
// 											0. Объекты UART
//=================================================================================================
	#if defined(RT_HW_PERMIT_SPI0)
       #define RT_HW_PRESENT_SPI0    
	#endif
//-------------------------------------------------------------------------------------------------
	#if defined(RT_HW_PERMIT_SPI1)
	#if defined(RT_HW_CREATE_SPI1)
       #define RT_HW_PRESENT_SPI1  
		SPIClass 			 SPI1x;
    #endif
	#endif	  
//=================================================================================================

//+++++++++++++++++++++++++++++++++++++++++++++++++++++++++++++++++++++++++++++++++++++++++++++++++
//										1.БАЗОВЫЕ ФУНКЦИИ SPI
//+++++++++++++++++++++++++++++++++++++++++++++++++++++++++++++++++++++++++++++++++++++++++++++++++
//=================================================================================================
//										1.1. Инициализации шины
//=================================================================================================
  uint8_t  	RT_HW_BASE:: 	spiBegin(uint8_t bus){
//-------------------------------------------------------------------------------------------------
	#if defined(RT_HW_PRESENT_SPI0)	
	 if(bus==0){
			LinkSPI0.codeErr=0;						//--Сброс кода ошибок;
	    if( LinkSPI0.status==1)	 {return 1;} 		//--Выход, если шина уже Master;
		if(!spiSetBusy(bus))	 {return 0;}		//--Захват шины или выход еcли шина занята;
		    spiEnd(bus);							//--Отключение шины SPI (если была инициал. SPIx.begin());
	        SPI.begin(LinkSPI0.sck,LinkSPI0.miso,LinkSPI0.mosi); //--Инициализация SPI;
						LinkSPI0.status=1;  		//--Установка статуса как Master;
						LinkSPI0.busy=0; 			//--Освобождение шины;
		return 1;
	}	
	#endif
//-------------------------------------------------------------------------------------------------
	#if defined(RT_HW_PRESENT_SPI1)	
	 if(bus==1){
			LinkSPI1.codeErr=0;						//--Сброс кода ошибок;
	    if( LinkSPI1.status==1)	 {return 1;} 		//--Выход, если шина уже Master;
		if(!spiSetBusy(bus))	 {return 0;}		//--Захват шины или выход еcли шина занята;
		    spiEnd(bus);							//--Отключение шины SPI (если была инициал. SPIx.begin());
	        SPI1x.begin(LinkSPI1.sck,LinkSPI1.miso,LinkSPI1.mosi); //--Инициализация SPI;
			SPI1x.setSCLK(LinkSPI1.sck); 			//--Установка sck;  
			SPI1x.setMISO(LinkSPI1.miso);			//--Установка miso;  
			SPI1x.setMOSI(LinkSPI1.mosi);			//--Установка mosi;
			SPI1x.begin(); 							//--Инициализация SPI;
			              LinkSPI1.status=1;  		//--Установка статуса как Master;  
						  LinkSPI1.busy=0;  		//--Освобождение шины;
		return 1;
	}	
	#endif
//-------------------------------------------------------------------------------------------------
	return 0;
};

//=================================================================================================
//										1.2. Отключение шины
//					ПРОВЕРИТЬ: SPIx.end()!!!
//=================================================================================================
  void		RT_HW_BASE::	spiEnd (uint8_t bus){
	(void)bus;
//-------------------------------------------------------------------------------------------------
	#if defined(RT_HW_PRESENT_SPI0)	
//		if(bus==0) {SPI.end(); 		return;}
	#endif
//-------------------------------------------------------------------------------------------------
	#if defined(RT_HW_PRESENT_SPI1)	
//		if(bus==1) {SPI1x.end(); 	return;}			
	#endif
//-------------------------------------------------------------------------------------------------
  };
//=================================================================================================
//										1.3. Начало транзакции
//=================================================================================================
  void 		RT_HW_BASE:: 	spiBeginTransaction(uint32_t speed, uint8_t bitOrder, uint8_t dataMode, uint8_t bus){
	(void)speed; (void)bitOrder; (void)dataMode; (void)bus;
//-------------------------------------------------------------------------------------------------
	#if defined(RT_HW_PRESENT_SPI0)	
		if(bus==0) {if(bitOrder){SPI.beginTransaction (SPISettings(speed,MSBFIRST,dataMode));}	
		else                    {SPI.beginTransaction (SPISettings(speed,LSBFIRST,dataMode));}
		return;
		}						 
	#endif
//-------------------------------------------------------------------------------------------------
	#if defined(RT_HW_PRESENT_SPI1)	
		if(bus==1) {if(bitOrder){SPI1x.beginTransaction (SPISettings(speed,MSBFIRST,dataMode));}	
		else                    {SPI1x.beginTransaction (SPISettings(speed,LSBFIRST,dataMode));}
		return;
		}						 
	#endif
//-------------------------------------------------------------------------------------------------
  };

//=================================================================================================
//										1.4. Завершение транзакции
//=================================================================================================
  void		RT_HW_BASE::	spiEndTransaction  (uint8_t bus){
	(void)bus;
//-------------------------------------------------------------------------------------------------
	#if defined(RT_HW_PRESENT_SPI0)	
		if(bus==0)   		 {SPI.endTransaction(); 	return;}
	#endif
//-------------------------------------------------------------------------------------------------
	#if defined(RT_HW_PRESENT_SPI1)	
		if(bus==1) 			 {SPI1x.endTransaction(); return;}
	#endif
//-------------------------------------------------------------------------------------------------
  };	
//=================================================================================================
//										1.5. Отправка байта tx, возвращает принятый байт
//=================================================================================================
  uint8_t  	RT_HW_BASE:: 	spiTransfer   (uint8_t  tx, uint8_t bus){
	(void)tx; (void)bus;
//-------------------------------------------------------------------------------------------------
	#if defined(RT_HW_PRESENT_SPI0)	
		if(bus==0)    {return SPI.transfer(tx);}
	#endif
//-------------------------------------------------------------------------------------------------
	#if defined(RT_HW_PRESENT_SPI1)	
		if(bus==1)    {return SPI1x.transfer(tx);}
	#endif
//-------------------------------------------------------------------------------------------------
	return 0;
  };
//=================================================================================================
//										1.6. Отправка байта tx, прием байта в rx
//=================================================================================================
  void  	RT_HW_BASE:: 	spiTransferVar (uint8_t  tx, uint8_t &rx, uint8_t bus){
	(void)tx; (void)rx; (void)bus;
//-------------------------------------------------------------------------------------------------
	#if defined(RT_HW_PRESENT_SPI0)	
		if(bus==0)    {rx=SPI.transfer(tx);		return;}
	#endif
//-------------------------------------------------------------------------------------------------
	#if defined(RT_HW_PRESENT_SPI1)	
		if(bus==1)    {rx=SPI1x.transfer(tx);	return;}
	#endif
//-------------------------------------------------------------------------------------------------
  };  
//=================================================================================================
//										1.7. Отправка qnt байт из arr[], 
//												прием qnt байт в  arr[]
//=================================================================================================
  void  	RT_HW_BASE:: 	spiTransferArr (uint8_t qnt, uint8_t *arr, uint8_t bus){
	for(uint8_t i=0; i<qnt; i++){
		arr[i]=spiTransfer(arr[i],bus);
	}
  }; 
//=================================================================================================
//										1.8. Отправка qnt байт из tx[], 
//												прием qnt байт в  rx[]
//=================================================================================================
  void  	RT_HW_BASE:: 	spiTransferArr (uint8_t qnt, uint8_t *tx, uint8_t *rx, uint8_t bus){
	(void)qnt; (void)tx; (void)rx; (void)bus; 
	for(uint8_t i=0; i<qnt; i++){
		rx[i]=spiTransfer(tx[i],bus);
	}
  };   
//=================================================================================================
//										1.9.Установка пинов sck,miso,mosi
// Для STM32   Ответственность за правильный выбор комбинации пинов лежит на пользователе;
//=================================================================================================
  void  	RT_HW_BASE:: 	spiSetPins(uint8_t sck, uint8_t miso, uint8_t mosi, uint8_t bus){ 
	(void)sck; (void)miso; (void)mosi; (void)bus; uint8_t bf; (void)bf;
//=================================================================================================
//++++SPI (SCK,MISO,MOSI) -  2, 4, 5;  6, 8, 7; 18,16;
//++++SPI1(SCK,MISO,MOSI) - 14, 8,15; 10,12,11;
//-------------------------------------------------------------------------------------------------
	#if defined(RT_HW_PRESENT_SPI0)	
	 if(bus==0){
						LinkSPI0.sck=sck;			//--Сохранение пина sck;
						LinkSPI0.miso=miso;			//--Сохранение пина miso;
						LinkSPI0.mosi=mosi;			//--Сохранение пина mosi;
		    return;
	}	
	#endif
//-------------------------------------------------------------------------------------------------
	#if defined(RT_HW_PRESENT_SPI1)	
	 if(bus==1){
						LinkSPI1.sck=sck;			//--Сохранение пина sck;
						LinkSPI1.miso=miso;			//--Сохранение пина miso;
						LinkSPI1.mosi=mosi;			//--Сохранение пина mosi;
		  return;
	}	
	#endif
//-------------------------------------------------------------------------------------------------
  };  
//=================================================================================================  
//+++++++++++++++++++++++++++++++++++++++++++++++++++++++++++++++++++++++++++++++++++++++++++++++++
#endif		//====END #if !defined(RT_HW_CREATE_SPI_CODE) && defined(RT_HW_CORE_ESP32)
//+++++++++++++++++++++++++++++++++++++++++++++++++++++++++++++++++++++++++++++++++++++++++++++++++
