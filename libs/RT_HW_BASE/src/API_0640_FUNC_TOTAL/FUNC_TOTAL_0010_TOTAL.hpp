
//+++++++++++++++++++++++++++++++++++++++++++++++++++++++++++++++++++++++++++++++++++++++++++++++++
//									1. НОРМАЛИЗАЦИЯ ПАРАМЕТРОВ
//+++++++++++++++++++++++++++++++++++++++++++++++++++++++++++++++++++++++++++++++++++++++++++++++++
//=================================================================================================
//							1.1.Получение максимального значения для разрядности depth
//=================================================================================================	
uint16_t maxBitDepth(uint8_t depth){
	if(depth>=16) {return 0xFFFF;} 
	if(depth==0)  {return 0;}  
	return ((1<<depth)-1);
}; 
//=================================================================================================
//							1.2.Получение максимального значения для системной разрядности SYS,ADC,PWM,DAC;
//=================================================================================================	
uint16_t maxBitDepthSYS(){return ((1<<getDepthSYS())-1);}; 
uint16_t maxBitDepthADC(){return ((1<<getDepthADC())-1);};	
uint16_t maxBitDepthPWM(){return ((1<<getDepthPWM())-1);};
uint16_t maxBitDepthDAC(){return ((1<<getDepthDAC())-1);};

//+++++++++++++++++++++++++++++++++++++++++++++++++++++++++++++++++++++++++++++++++++++++++++++++++
//									2. НОРМАЛИЗАЦИЯ ПАРАМЕТРОВ ADC,PWM,DAC
//+++++++++++++++++++++++++++++++++++++++++++++++++++++++++++++++++++++++++++++++++++++++++++++++++	  
uint16_t normADC(uint16_t v){return map(v,0,maxBitDepthADC(),0,maxBitDepthSYS());};  
uint16_t normPWM(uint16_t v){return map(v,0,maxBitDepthSYS(),0,maxBitDepthPWM());};  
uint16_t normDAC(uint16_t v){return map(v,0,maxBitDepthSYS(),0,maxBitDepthDAC());};


//+++++++++++++++++++++++++++++++++++++++++++++++++++++++++++++++++++++++++++++++++++++++++++++++++
//									3. ПОИСК СВОБОДНЫХ УСТРОЙСТВ
//+++++++++++++++++++++++++++++++++++++++++++++++++++++++++++++++++++++++++++++++++++++++++++++++++
//=================================================================================================
//	 							3.1. Захват свободного устройства(1:15) 
//  1.Устанавливает первый свободный бит регистра и возвращает его номер;
//  2.Если свободного номера не обнаружено, возвращает 0.
//=================================================================================================
  uint8_t  setFistFreeDevice(uint16_t &reg, uint8_t maxNum=16){				
  if((maxNum>16) || (maxNum==0)) {return 0;} 
  for(uint8_t i=1; i<=maxNum; i++){if(!bitRead(reg,(i-1))) {bitSet(reg,(i-1)); return i;}} return 0;};	
//=================================================================================================
//	 							3.2.Возвращает кол-во занятых устройств								
//=================================================================================================
uint8_t  getQntDevice(uint16_t &reg){	
  uint8_t qnt=0; for(uint8_t i=1; i<=16; i++) {if(!bitRead(reg,(i-1))) {qnt++;}} 
  return qnt;
};

//+++++++++++++++++++++++++++++++++++++++++++++++++++++++++++++++++++++++++++++++++++++++++++++++++
//									4. РЕВЕРС БИТ
//+++++++++++++++++++++++++++++++++++++++++++++++++++++++++++++++++++++++++++++++++++++++++++++++++
//=================================================================================================
//									4.1. Reverse bit v8
//=================================================================================================
  inline uint8_t reverseV8(uint8_t b) {
    b = (b & 0xF0) >> 4 | (b & 0x0F) << 4;
    b = (b & 0xCC) >> 2 | (b & 0x33) << 2;
    b = (b & 0xAA) >> 1 | (b & 0x55) << 1;
    return b;
};
//=================================================================================================
//									4.2. Reverse bit v16
//-------------------------------------------------------------------------------------------------
//  uint16_t x = _dataOut;                              //  x = 0123456789ABCDEF
//  x = (((x & 0xAAAA) >> 1) | ((x & 0x5555) << 1));    //  x = 1032547698BADCFE
//  x = (((x & 0xCCCC) >> 2) | ((x & 0x3333) << 2));    //  x = 32107654BA98FEDC
//  x = (((x & 0xF0F0) >> 4) | ((x & 0x0F0F) << 4));    //  x = 76543210FEDCBA98
//  x = (x >> 8) | ( x << 8);                           //  x = FEDCBA9876543210
//=================================================================================================
  uint16_t reverseV16(uint16_t v) {//uint8_t v0=v & 0xFF; uint8_t v1=(v>>8) & 0xFF; 
  return ((reverseV8(v & 0xFF)<< 8) | reverseV8((v>>8) & 0xFF));
};
//=================================================================================================
//									4.3. Reverse bit v24
//=================================================================================================
  uint32_t reverseV24(uint32_t v) {uint8_t v0=v & 0xFF; uint8_t v1=(v>>8) & 0xFF; uint8_t v2=(v>>16) & 0xFF; 
  return ((((uint32_t)reverseV8(v0))<<16) | (((uint32_t)reverseV8(v1))<< 8) | reverseV8(v2));
};
//=================================================================================================
//									4.4. Reverse bit v32
//=================================================================================================
  uint32_t reverseV32(uint32_t v) {
  uint8_t v0=v & 0xFF; uint8_t v1=(v>>8) & 0xFF; uint8_t v2=(v>>16) & 0xFF; uint8_t v3=(v>>24) & 0xFF; 
  return ((((uint32_t)reverseV8(v0))<<24) | (((uint32_t)reverseV8(v1))<<16) | (((uint32_t)reverseV8(v2))<< 8) | reverseV8(v3));
};
//=================================================================================================

//+++++++++++++++++++++++++++++++++++++++++++++++++++++++++++++++++++++++++++++++++++++++++++++++++
//
//									5. ПРОВЕРКА ИЗМЕНЕНИЯ ПЕРЕМЕННЫХ И МАССИВОВ
//
//+++++++++++++++++++++++++++++++++++++++++++++++++++++++++++++++++++++++++++++++++++++++++++++++++                                  
//=================================================================================================
//									5.1. Проверка изменения переменных
//=================================================================================================
uint8_t checkChange(int8_t   &a, int8_t   v){if(a==v){return 0;} a=v; return 1;};
uint8_t checkChange(uint8_t  &a, uint8_t  v){if(a==v){return 0;} a=v; return 1;};
uint8_t checkChange(int16_t  &a, int16_t  v){if(a==v){return 0;} a=v; return 1;};
uint8_t checkChange(uint16_t &a, uint16_t v){if(a==v){return 0;} a=v; return 1;};

void checkChangeVAR(uint8_t &change,   int8_t &a,   int8_t  v){change=0; if(a!=v){change=1;} if(change){a=v;}};
void checkChangeVAR(uint8_t &change,  uint8_t &a,  uint8_t  v){change=0; if(a!=v){change=1;} if(change){a=v;}};
void checkChangeVAR(uint8_t &change,  int16_t &a,  int16_t  v){change=0; if(a!=v){change=1;} if(change){a=v;}};
void checkChangeVAR(uint8_t &change, uint16_t &a, uint16_t  v){change=0; if(a!=v){change=1;} if(change){a=v;}};
void checkChangeVAR(uint8_t &change,  int32_t &a,  int32_t  v){change=0; if(a!=v){change=1;} if(change){a=v;}};
void checkChangeVAR(uint8_t &change, uint32_t &a, uint32_t  v){change=0; if(a!=v){change=1;} if(change){a=v;}};
void checkChangeVAR(uint8_t &change,     char &a,     char  v){change=0; if(a!=v){change=1;} if(change){a=v;}};
void checkChangeVAR(uint8_t &change,   String &a,   String  v){change=0; if(a!=v){change=1;} if(change){a=v;}};
//-------------------------------------------------------------------------------------------------
void checkChangeVAR(uint8_t &change,    float &a,     float v){change=0; if((int32_t)(a*100)!=(int32_t)(v*100)){change=1;} if(change){a=v;}};

//=================================================================================================
//									5.2. Проверка изменения переменных в массиве
//=================================================================================================
void checkChangeVAR(uint8_t &change,   int8_t *a,   int8_t *v, uint8_t qnt){change=0; uint8_t ch=0; for(uint8_t i=0; i<qnt; i++){checkChangeVAR(ch,a[i],v[i]); if(ch){change=1;}}};
void checkChangeVAR(uint8_t &change,  uint8_t *a,  uint8_t *v, uint8_t qnt){change=0; uint8_t ch=0; for(uint8_t i=0; i<qnt; i++){checkChangeVAR(ch,a[i],v[i]); if(ch){change=1;}}};
void checkChangeVAR(uint8_t &change,  int16_t *a,  int16_t *v, uint8_t qnt){change=0; uint8_t ch=0; for(uint8_t i=0; i<qnt; i++){checkChangeVAR(ch,a[i],v[i]); if(ch){change=1;}}};
void checkChangeVAR(uint8_t &change, uint16_t *a, uint16_t *v, uint8_t qnt){change=0; uint8_t ch=0; for(uint8_t i=0; i<qnt; i++){checkChangeVAR(ch,a[i],v[i]); if(ch){change=1;}}};
void checkChangeVAR(uint8_t &change,  int32_t *a,  int32_t *v, uint8_t qnt){change=0; uint8_t ch=0; for(uint8_t i=0; i<qnt; i++){checkChangeVAR(ch,a[i],v[i]); if(ch){change=1;}}};
void checkChangeVAR(uint8_t &change, uint32_t *a, uint32_t *v, uint8_t qnt){change=0; uint8_t ch=0; for(uint8_t i=0; i<qnt; i++){checkChangeVAR(ch,a[i],v[i]); if(ch){change=1;}}};
void checkChangeVAR(uint8_t &change,     char *a,     char *v, uint8_t qnt){change=0; uint8_t ch=0; for(uint8_t i=0; i<qnt; i++){checkChangeVAR(ch,a[i],v[i]); if(ch){change=1;}}};
void checkChangeVAR(uint8_t &change,   String *a,   String *v, uint8_t qnt){change=0; uint8_t ch=0; for(uint8_t i=0; i<qnt; i++){checkChangeVAR(ch,a[i],v[i]); if(ch){change=1;}}};
//--------------------------------------------------------------------------------------------------
void checkChangeVAR(uint8_t &change,    float *a,    float *v, uint8_t qnt){change=0; uint8_t ch=0; for(uint8_t i=0; i<qnt; i++){checkChangeVAR(ch,a[i],v[i]); if(ch){change=1;}}};
//=================================================================================================



//+++++++++++++++++++++++++++++++++++++++++++++++++++++++++++++++++++++++++++++++++++++++++++++++++
//									6. ФУНКЦИИ ДОПОЛНИТЕЛЬНЫЕ
//+++++++++++++++++++++++++++++++++++++++++++++++++++++++++++++++++++++++++++++++++++++++++++++++++                                  

//=================================================================================================
//									6.1. Функция гистерезиса 
// Меняет значение var на cur при его отклонение на delta 
//=================================================================================================	
uint16_t makeDelta(uint16_t &var, uint16_t cur, uint8_t delta){			
  if(cur>var){if((cur-var)>delta){var=cur;}} 
  if(cur<var){if((var-cur)>delta){var=cur;}} return var;
}
//=================================================================================================
//									6.2. Извлечение цифры из числа
// Возвращает цифру(как символ) из vaк начиная со старшей позиции;
// mode B,b,H,h,D,I,0,1,2,3,T; upper =0 верхний регистр, =1 нижний регистр;
//=================================================================================================
uint8_t	getCharVar(uint32_t var,uint8_t upper,char mode,uint8_t len,uint8_t n){
  uint32_t  bf32=0;
  if((mode=='B') || (mode=='b')) {bf32=(var>>(len-n))&1;}
  if((mode=='H') || (mode=='h')) {bf32=(var>>(len-n)*4)&0xf;}
  if((mode=='D') || (mode=='I') ||(mode=='U')|| (mode=='0') ||(mode=='1') ||(mode=='2') || (mode=='3') || (mode=='T')) 
                                          {n=len-n+1; while(n!=0) {bf32=var; var/=10; bf32=bf32-(var*10); n--;};}
  if(bf32<=9) {bf32=bf32 +'0';} else {bf32=bf32-10+(upper ? 'A' : 'a') ;}
  return (uint8_t)bf32;
}; 
//=================================================================================================



//=================================================================================================
//									7x. Функция защиты от дребезга
//   Устаревшая функция - оставлена для совместимости со старыми блоками FLProg (26.02.2024)
//   Рекомендуется использовать RT_HW_FILTER_CHATTER.h - фильтр дребезга переменной.
//=================================================================================================
bool chatterDIN(RT_HW_CHATTER_DIN &id, uint8_t var, uint16_t period){
  if(id.dir==0) {if(id.ago!=var){id.timeBegin=millis(); id.dir++;}               return id.ago;}
  if(id.dir==1) {if((getPastMs  (id.timeBegin)< period) && (id.ago==var)) {id.dir=0; return id.ago;} 
			     if( getPastMs  (id.timeBegin)> period)    {id.ago=var;	   id.dir=0; return id.ago;}}
                                                                                     return 0;
}; //--END chatterDIN();


/*
//+++++++++++++++++++++++++++++++++++++++++++++++++++++++++++++++++++++++++++++++++++++++++++++++++
//
//				1.ФУНКЦИИ ПОЛУЧЕНИЕ СТРОКОВЫХ ПАРАМЕТРОВ КОНТРОЛЛЕРА (из Selectt_xxx.hpp & etc.)
//
//+++++++++++++++++++++++++++++++++++++++++++++++++++++++++++++++++++++++++++++++++++++++++++++++++
//=================================================================================================
//									1.1. Получение имени версии библиотеки
//=================================================================================================
  String getVerName(){				 	//--Имя версии;	
	#if defined(RT_HW_BASE_VER_NAME) 					
		return RT_HW_BASE_VER_NAME;  
	#else
		return "";
	#endif
  };
//=================================================================================================
//									1.2.1. Получение имени платы
//=================================================================================================
  String getBoardName(){			
	#if defined(RT_HW_BOARD_NAME) 					
		return String(RT_HW_BOARD_NAME);  
	#else
		return "";
	#endif
  };
//=================================================================================================
//									1.2.2. Получение кода платы
//=================================================================================================
  uint16_t getBoardCode(){					
	#if defined(RT_HW_BOARD_CODE) 					
		return RT_HW_BOARD_CODE;  
	#else
		return "";
	#endif
  };  
//=================================================================================================
//									1.3.1. Получение имени архитектуры
//=================================================================================================
  String getArchName(){							
	#if defined(RT_HW_ARCH_NAME) 					
		return RT_HW_ARCH_NAME;  
	#else
		return "";
	#endif
  };
//=================================================================================================
//									1.3.2. Получение кода архитектуры
//=================================================================================================
uint8_t getArchCode(){					
#if defined(RT_HW_ARCH_CODE) 					
    return  RT_HW_ARCH_CODE;  
#else
	return 255;
#endif
};
//-------------------------------------------------------------------------------------------------
String getCoreName(){						//--Имя ядра(CORE);	
#if defined(RT_HW_CORE_NAME) 					
	return RT_HW_CORE_NAME;  
#else
	return "";
#endif
};
//-------------------------------------------------------------------------------------------------
String getBoardSelect(){					//--Наименование выбранной платы;	
#if defined(RT_HW_BOARD_SELECT) 					
	return RT_HW_BOARD_SELECT;  
#else
	return "";
#endif
};
//-------------------------------------------------------------------------------------------------
String getBoardMemory(){					//--Наименование выбранной платы;	
#if defined(RT_HW_BOARD_MEMORY) 					
	return RT_HW_BOARD_MEMORY;  
#else
	return "";
#endif
};
//-------------------------------------------------------------------------------------------------
uint16_t getFCPU(){					//--Частота процессора (в файлах Select_XXX);	
#if defined(RT_HW_BOARD_FCPU) 					
    return  RT_HW_BOARD_FCPU;  
#else
	return 16;
#endif
};
//-------------------------------------------------------------------------------------------------
uint16_t getVcc(){					//--Напряжение процессора (в файлах Select_XXX);	
#if defined(RT_HW_BOARD_VCC) 					
    return  RT_HW_BOARD_VCC;  
#else
	return 3300;
#endif
};
//-------------------------------------------------------------------------------------------------



//+++++++++++++++++++++++++++++++++++++++++++++++++++++++++++++++++++++++++++++++++++++++++++++++++
//									1. ПОЛУЧЕНИЕ ПАРАМЕТРОВ РАЗРЯДНОСТИ
//+++++++++++++++++++++++++++++++++++++++++++++++++++++++++++++++++++++++++++++++++++++++++++++++++
//=================================================================================================
//									1.1. Получение разрядности SYSTEM
//=================================================================================================
  uint8_t getDepthSYS(){
	#if defined(RT_HW_DEPTH_SYS)
		return  RT_HW_DEPTH_SYS;
	#else
		return 12;	 
	#endif
  };
//=================================================================================================
//									1.2.1. Получение разрядности ADC
//=================================================================================================
  uint8_t getDepthADC(){
	#if defined(RT_HW_DEPTH_ADC)
		return  RT_HW_DEPTH_ADC;
	#else
		return 10;	 
	#endif
  };
//=================================================================================================
//									1.2.2. Получение дрейфа значения ADC
//=================================================================================================
  uint8_t getDriftADC(){
	#if defined(RT_HW_DRIFT_ADC)
		return  RT_HW_DRIFT_ADC;
	#else
		return 10;	 
	#endif
  }; 
//=================================================================================================
//									1.2.3. Получение дрейфа нуля ADC
//=================================================================================================  
   uint8_t getNullADC(){
	#if defined(RT_HW_NULL_ADC)
		return  RT_HW_NULL_ADC;
	#else
		return 10;	 
	#endif
  }; 
//=================================================================================================
//									1.3. Получение значения пина DEPTH PWM
//=================================================================================================
  uint8_t getDepthPWM(){
	#if defined(RT_HW_DEPTH_PWM)
		return  RT_HW_DEPTH_PWM;
	#else
		return 8;	 
	#endif
  };
//=================================================================================================
//									1.4. Получение значения пина DEPTH DAC
//=================================================================================================
  uint8_t getDepthDAC(){
	#if defined(RT_HW_DEPTH_DAC)
		return  RT_HW_DEPTH_DAC;
	#else
		return 8;	 
	#endif
  };
*/  
  