//+++++++++++++++++++++++++++++++++++++++++++++++++++++++++++++++++++++++++++++++++++++++++++++++++
//
// 								ФУНКЦИИ ВВОДА-ВЫВОДА НА ПИНАХ КОНТРОЛЛЕРА
//									  			  STM32
//+++++++++++++++++++++++++++++++++++++++++++++++++++++++++++++++++++++++++++++++++++++++++++++++++
#if !defined(RT_HW_CORE_GPIO) && defined(RT_HW_CORE_STM32)
    #define  RT_HW_CORE_GPIO 		
//+++++++++++++++++++++++++++++++++++++++++++++++++++++++++++++++++++++++++++++++++++++++++++++++++
//=================================================================================================
//									20. DIR:: Дискретный вывод
// mode:   'N'-нормальный вывод; 'O'-открытый коллектор.
//================================================================================================O
  void  	pinDigitalWrite	(RT_HW_PIN_DIR_ID &id, 				uint8_t var){
	(void)id; (void)var; 
  #if defined RT_HW_PERMIT_PIN_DOT
//-------------------------------------------------------------------------------------------------
//									20.0. Настройка пина
//-------------------------------------------------------------------------------------------------
	if(id.dir==0){
		if(!checkPinDOT(id.pin)){id.dir=50; return;}			//--Проверка допустимости пина 		
		id.bitMask= RT_HW_PIN_TO_BITMASK(id.pin); 
		id.baseReg= RT_HW_PIN_TO_BASEREG(id.pin);;
    id.dir=1;
  //if(id.inv) 	{digitalWrite(id.pin,0); pinMode(id.pin, OUTPUT); id.dir=2;}		 //--Инициализация инверсного вывода;
  //else 		{digitalWrite(id.pin,1); pinMode(id.pin, OUTPUT); id.dir=1;}		 //--Инициализация прямого    вывода;
	if((!id.inv) && (id.mode!='O')){digitalWrite(id.pin, var); pinMode(id.pin, OUTPUT); 			id.dir=1;} //--Инициализация inv=0, mode!='O';	
	if((!id.inv) && (id.mode=='O')){digitalWrite(id.pin,!var); pinMode(id.pin, OUTPUT_OPEN_DRAIN);  id.dir=2;} //--Инициализация inv=0, mode ='O';
    if(( id.inv) && (id.mode!='O')){digitalWrite(id.pin,!var); pinMode(id.pin, OUTPUT); 			id.dir=1;} //--Инициализация inv=1, mode!='O';	
	if(( id.inv) && (id.mode=='O')){digitalWrite(id.pin, var); pinMode(id.pin, OUTPUT_OPEN_DRAIN);  id.dir=2;} //--Инициализация inv=1, mode ='O';
	if(id.dir==0)	{id.inv=0;      digitalWrite(id.pin, var); pinMode(id.pin, OUTPUT); 			id.dir=1;} //--Если не определен;	
	}
//-------------------------------------------------------------------------------------------------
//									20.1. Запись пина - прямое значение
//-------------------------------------------------------------------------------------------------
	if(id.dir==1){   
    #if !defined(RT_HW_BLOCK_QUICK_PIN)
		id.cash=var;
		if(id.inv)	{digitalWrite(id.pin,!id.cash);}
		else  		{digitalWrite(id.pin, id.cash);}
		//if(id.cash)	{RT_HW_DIRECT_WRITE_HIGH(id.baseReg, id.bitMask);}
		//else  		{RT_HW_DIRECT_WRITE_LOW(id.baseReg,  id.bitMask);}
    #else
		id.cash=var;
		if(id.inv)	{digitalWrite(id.pin,!id.cash);}
		else  		{digitalWrite(id.pin, id.cash);}
    #endif
    return;
	}
//-------------------------------------------------------------------------------------------------
//									20.2. Запись пина обратного значения (для открытого выхода)
//-------------------------------------------------------------------------------------------------
	if(id.dir==2){   
    #if !defined(RT_HW_BLOCK_QUICK_PIN)
		id.cash=var;
		if(id.inv)	{digitalWrite(id.pin, id.cash);}
		else  		{digitalWrite(id.pin,!id.cash);}
    #else
		id.cash=var;
		if(id.inv)	{digitalWrite(id.pin,!id.cash);}
		else  		{digitalWrite(id.pin, id.cash);}
    #endif
    return;
	}	
//-------------------------------------------------------------------------------------------------
  #endif
//-------------------------------------------------------------------------------------------------  
  };	//--END pinDigitalWrite();
//=================================================================================================
//									21. DIR:: Дискретный (для совместимости)
//=================================================================================================
  void		pinDigitalWrite	(RT_HW_PIN_DIR_ID &id, uint8_t pin, uint8_t var, char mode){
	                        id.mode=mode;	id.pin=pin; 	pinDigitalWrite(id, var);}
//-------------------------------------------------------------------------------------------------
  void		pinDigitalWrite	(RT_HW_PIN_DIR_ID &id, uint8_t pin, uint8_t var){
	                                        id.pin=pin; 	pinDigitalWrite(id, var);}
//------------------------------------------------------------------------------------------------- 

//=================================================================================================
//									22. DIR:: Дискретный ввод
// mode:    I->дискретный ввод; 
//          U->дискретный ввод с подтяжкой к +Vcc; 
//		    D->дискретный ввод с подтяжкой к  GND; 
// Примечание: если указан недопустимый режим(помимо перечисленных) 
//             или режим недопустимый для выбранного MCU инициализируется как ввод без подтяжки;
//=================================================================================================
  uint8_t 	pinDigitalRead	(RT_HW_PIN_DIR_ID &id){ 
	(void)id; 
  #if defined RT_HW_PERMIT_PIN_DIN
//-------------------------------------------------------------------------------------------------
//									22.0. Настройка пина
//-------------------------------------------------------------------------------------------------
	if(id.dir==0){
		if(!checkPinDIN(id.pin)){id.dir=50; return 0;}		//--Проверка допустимости пина 
		id.baseReg = RT_HW_PIN_TO_BASEREG(id.pin);			//--Номер базового регистра;
		id.bitMask = RT_HW_PIN_TO_BITMASK(id.pin);			//--Номер бита в базовом регистре;		
		if(id.mode=='U') {pinMode(id.pin, INPUT_PULLUP);}	//--Инициализация дискретного ввода с подтяжкой к +Vcc;
		else 			 {pinMode(id.pin, INPUT);}			//--Инициализация дискретного ввода без подтяжки;;
		id.dir=1;
	}
//-------------------------------------------------------------------------------------------------
//									22.1. Чтение пина
//-------------------------------------------------------------------------------------------------
	if(id.dir==1){
    #if !defined(RT_HW_BLOCK_QUICK_PIN)
		if(id.inv){return !RT_HW_DIRECT_READ(id.baseReg, id.bitMask);}	//--Быстрое чтение; 
		else      {return  RT_HW_DIRECT_READ(id.baseReg, id.bitMask);}	//--Быстрое чтение; 
    #else
		if(id.inv){return !digitalRead(id.pin);}						//--Чтение функцией Arduino IDE;
		else      {return  digitalRead(id.pin);}
    #endif
	}
//-------------------------------------------------------------------------------------------------
  #endif
//-------------------------------------------------------------------------------------------------
	return 0;
  };	//--END pinDigitalRead();
//================================================================================================
//									23. DIR:: Дискретный ввод (для совместимости)
//=================================================================================================
  uint8_t 	pinDigitalRead	(RT_HW_PIN_DIR_ID &id, uint8_t _pin){
	                                        if(id.pin!=_pin){id.pin=_pin; id.dir=0;} return pinDigitalRead(id);};
//-------------------------------------------------------------------------------------------------
  uint8_t 	pinDigitalRead	(RT_HW_PIN_DIR_ID &id, uint8_t _pin, char _mode='N'){
			id.mode=_mode; if(id.pin!=_pin){id.pin=_pin; id.dir=0;} return pinDigitalRead(id);}; 
//=================================================================================================
//									24. DIR:: Дискретный ввод (DIN) с защитой от дребезга
// mode:    I->дискретный ввод; 
//          U->дискретный ввод с подтяжкой к +Vcc; 
//		    D->дискретный ввод с подтяжкой к  GND; 
// 	 	    F->дискретный ввод с плавающим входом (STM32) (floating entrance);
// Примечание: если указан недопустимый режим(помимо перечисленных) 
//             или режим недопустимый для выбранного MCU инициализируется как ввод без подтяжки (I);
//=================================================================================================
  uint8_t pinDigitalRead(RT_HW_PIN_DIR_ID &id, uint32_t &timeBegin, uint16_t period, uint8_t pin, char mode='I'){ 
	(void)id; (void)timeBegin; (void)period; (void)pin; (void)mode;
//-------------------------------------------------------------------------------------------------
  #if defined(RT_HW_PERMIT_PIN_DIN)
//-------------------------------------------------------------------------------------------------
//									24.0. Настройка пина
//-------------------------------------------------------------------------------------------------
	if(id.dir==0){
		if(!checkPinDIN(pin)){id.dir=50; return 0;}			//--Проверка допустимости пина 
		id.pin=pin;											//--Сохранение номера пина;	
		id.mode=mode;										//--Сохранение режима настройки пина;
		id.baseReg = RT_HW_PIN_TO_BASEREG(id.pin);			//--Номер базового регистра;
		id.bitMask = RT_HW_PIN_TO_BITMASK(id.pin);			//--Номер бита в базовом регистре;		
		if(id.mode=='U') {pinMode(id.pin, INPUT_PULLUP);}	//--Инициализация дискретного ввода с подтяжкой к +Vcc;
		else 			 {pinMode(id.pin, INPUT);}			//--Инициализация дискретного ввода без подтяжки;;
		//-----------------------------------------------------------------------------------------
		if(id.inv){id.cash=!RT_HW_DIRECT_READ(id.baseReg, id.bitMask);}
		else	  {id.cash= RT_HW_DIRECT_READ(id.baseReg, id.bitMask);}
		id.dir=1;
	}
//-------------------------------------------------------------------------------------------------
//									24.1. Чтение пина c защитой от дребезга
//-------------------------------------------------------------------------------------------------
	if(id.dir==1){
		uint8_t var=RT_HW_DIRECT_READ(id.baseReg, id.bitMask);	
        if(id.cash!=var){timeBegin=millis(); id.dir=2;} 
	}
//-------------------------------------------------------------------------------------------------
	if(id.dir==2){
		uint8_t var=RT_HW_DIRECT_READ(id.baseReg, id.bitMask); 
		if((getPastMs(timeBegin)< period) && (id.cash==var)) {id.dir=1;} 
		if( getPastMs(timeBegin)>=period)    {id.cash=var;	  id.dir=1;}
	}
//-------------------------------------------------------------------------------------------------
  #endif		//==RT_HW_pinDigitalRead(дребезг)->#if defined(RT_HW_PERMIT_PIN_DIN)
	return  id.cash;
  };

//=================================================================================================
//									25. DINB: Дискретный ввод с защитой от дребезга
// mode:    I->дискретный ввод; 
//          U->дискретный ввод с подтяжкой к +Vcc; 
//		    D->дискретный ввод с подтяжкой к  GND; 
// 	 	    F->дискретный ввод с плавающим входом (STM32) (floating entrance);
// Примечание: если указан недопустимый режим(помимо перечисленных) 
//             или режим недопустимый для выбранного MCU инициализируется как ввод без подтяжки (I);
//=================================================================================================
  uint8_t 	pinDigitalRead	(RT_HW_PIN_DIB_ID &id){ 
	(void)id; 
//-------------------------------------------------------------------------------------------------
  #if defined(RT_HW_PERMIT_PIN_DIN)
//-------------------------------------------------------------------------------------------------
//									25.0. Настройка пина
//-------------------------------------------------------------------------------------------------
	if(id.dir==0){
		if(!checkPinDIN(id.pin)){id.dir=50; return 0;}		//--Проверка допустимости пина 
		id.baseReg = RT_HW_PIN_TO_BASEREG(id.pin);			//--Номер базового регистра;
		id.bitMask = RT_HW_PIN_TO_BITMASK(id.pin);			//--Номер бита в базовом регистре;		
		if(id.mode=='U') {pinMode(id.pin, INPUT_PULLUP);}	//--Инициализация дискретного ввода с подтяжкой к +Vcc;
		else 			 {pinMode(id.pin, INPUT);}			//--Инициализация дискретного ввода без подтяжки;;
		//-----------------------------------------------------------------------------------------
		if(id.inv){id.cash=!RT_HW_DIRECT_READ(id.baseReg, id.bitMask);}
		else	  {id.cash= RT_HW_DIRECT_READ(id.baseReg, id.bitMask);}
		id.dir=1;
	}
//-------------------------------------------------------------------------------------------------
//									25.1. Предварительное чтение пина c защитой от дребезга
//-------------------------------------------------------------------------------------------------
	if(id.dir==1){
		uint8_t var=RT_HW_DIRECT_READ(id.baseReg, id.bitMask);
		if(id.inv){var=!var;}
        if(id.cash!=var){id.timeBegin=millis(); id.dir=2;} 
	}
//-------------------------------------------------------------------------------------------------
//									25.2. Контрольное чтение пина c защитой от дребезга
//-------------------------------------------------------------------------------------------------
	if(id.dir==2){
		uint8_t var=RT_HW_DIRECT_READ(id.baseReg, id.bitMask);
		if(id.inv){var=!var;}
		if((getPastMs(id.timeBegin)< id.period) && (id.cash==var)) {id.dir=1;} 
		if( getPastMs(id.timeBegin)>=id.period)    {id.cash=var;	id.dir=1;}
	}
//-------------------------------------------------------------------------------------------------
  #endif		//==RT_HW_pinDigitalRead(дребезг)->#if defined(RT_HW_PERMIT_PIN_DIN)
	return id.cash;
  };
//=================================================================================================
//									26. DINB: Дискретный ввод с защитой от дребезга  (для совместимости)
//=================================================================================================
  uint8_t 	pinDigitalRead(RT_HW_PIN_DIB_ID &id, uint8_t _pin, uint16_t _period){
				if(id.pin!=_pin){id.pin=_pin; id.dir=0;} id.period=_period; return pinDigitalRead(id);}; 
//-------------------------------------------------------------------------------------------------
  uint8_t 	pinDigitalRead(RT_HW_PIN_DIB_ID &id, uint8_t _pin)                  {
				if(id.pin!=_pin){id.pin=_pin; id.dir=0;}                    return pinDigitalRead(id);}; 

//=================================================================================================
//									27. Аналоговый ввод (ADC)
//=================================================================================================
  void  pinAnalogRead(RT_HW_PIN_ADC_ID &id){
	(void)id; 
  #if defined RT_HW_PERMIT_PIN_ADC
//-------------------------------------------------------------------------------------------------
//									27.0. Настройка пина (ADC)
//-------------------------------------------------------------------------------------------------
	if(id.dir==0){
		if(!checkPinADC(id.pin)){id.dir=50; return;}				//--Проверка допустимости пина;	
		analogReadResolution(getDepthADC());		
		//pinMode(id.pin, INPUT);									//--Настройка пина для других MCU;;
		id.dir=1;
	}
//-------------------------------------------------------------------------------------------------
//									27.1. Чтение пина (ADC)
//-------------------------------------------------------------------------------------------------
	if(id.dir==1){;
		id.vPin=analogRead(id.pin);
//-------------------------------------------------------------------------------------------------
//									27.1.1. Фильтр дрейфа показаний и дрейфа нуля
//-------------------------------------------------------------------------------------------------
        uint16_t vMax=maxBitDepthADC();		
	if(id.vDev>id.vPin){if((id.vDev-id.vPin)>RT_HW_ADC_DRIFT){id.vDev=id.vPin;}}
	if(id.vDev<id.vPin){if((id.vPin-id.vDev)>RT_HW_ADC_DRIFT){id.vDev=id.vPin;}}
		if(id.vDev>vMax)   {id.vDev=vMax;}
		if(id.vDev<RT_HW_ADC_NULL){id.vDev=0;}
//-------------------------------------------------------------------------------------------------
//									27.1.2. Нормализация значения vDev
//-------------------------------------------------------------------------------------------------
		id.vNorm=normADC(id.vDev);
	}
//-------------------------------------------------------------------------------------------------
  #endif
//------------------------------------------------------------------------------------------------- 
  };	//--END pinADC();
//=================================================================================================
//									28. ADC:: Аналоговый ввод  (для совместимости)
//=================================================================================================
  void  pinAnalogRead(RT_HW_PIN_ADC_ID &id, uint8_t _pin){
				if(id.pin!=_pin){id.pin=_pin; id.dir=0;}   pinAnalogRead(id);};

//=================================================================================================
//									29.  DAC::  Аналоговый вывод
//=================================================================================================
  void 		pinWriteDAC(RT_HW_PIN_DAC_ID &id, uint16_t var){  
	(void)id; (void)var;	
 #if defined(RT_HW_PERMIT_PIN_DAC) 	
//-------------------------------------------------------------------------------------------------
//									21.0. Настройка пина
//-------------------------------------------------------------------------------------------------
	if(id.dir==0){
		if(!checkPinDAC(id.pin)){id.dir=50; return;}//--Проверка допустимости пина; 
//-------------------------------------------------------------------------------------------------
//									21.0.1. STM32F1V
//------------------------------------------------------------------------------------------------- 
	#if defined(RT_HW_CORE_STM32F1V)	
		if(id.pin==PA4){RCC->APB1ENR |= RCC_APB1ENR_DACEN;  DAC->CR |= DAC_CR_EN1;}          //вкл. тактирование ЦАП, вкл. ЦАП 1; 
		if(id.pin==PA5){RCC->APB1ENR |= RCC_APB1ENR_DACEN;  DAC->CR |= DAC_CR_EN2;}          //вкл. тактирование ЦАП, вкл. ЦАП 1;    
	#endif
//-------------------------------------------------------------------------------------------------
//									21.0.2. STM32F407V
//-------------------------------------------------------------------------------------------------  
	#if defined(RT_HW_CORE_STM32F4V)
		analogWriteResolution(getDepthDAC());
	#endif
//-------------------------------------------------------------------------------------------------  
		id.dir=1;
	} 				   
//-------------------------------------------------------------------------------------------------
//									21.1. Настройка пина
//-------------------------------------------------------------------------------------------------
	if(id.dir==1){			
//-------------------------------------------------------------------------------------------------
//									21.1.1. STM32F1V
//------------------------------------------------------------------------------------------------- 
	#if defined(RT_HW_CORE_STM32F1V) 
		id.cash=normDAC(var);
		if(id.pin==PA4){DAC->DHR12R1 = id.cash; return;}       // загрузка данных в ЦАП1
		if(id.pin==PA5){DAC->DHR12R2 = id.cash; return;}       // загрузка данных в ЦАП2
	#endif
//-------------------------------------------------------------------------------------------------
//									21.1.2. STM32F4V
//------------------------------------------------------------------------------------------------- 
	#if defined(RT_HW_CORE_STM32F4V) 		
		id.cash=normDAC(var);		
		analogWrite(id.pin,id.cash);            return;
	#endif	
//-------------------------------------------------------------------------------------------------
	}  //--END if (id.dir==1)
//-------------------------------------------------------------------------------------------------
  #endif
//-------------------------------------------------------------------------------------------------
  };	//--END pinDAC();	
//=================================================================================================
//									30.  DAC:: Аналоговый вывод (для совместимости)
//=================================================================================================
  void  	pinDAC			(RT_HW_PIN_DAC_ID &id, uint8_t pin, uint16_t var){id.pin=pin; pinWriteDAC(id, var);}; 

//=================================================================================================
//									40. PWM:: Широтно-импульсный вывод 
//=================================================================================================
  void  	pinSetPWM		(RT_HW_PIN_PWM_ID &id, uint8_t depth=12, uint16_t freq=500){(void)id; (void)depth; (void)freq;};	  
//-------------------------------------------------------------------------------------------------
  void  	pinWritePWM  	(RT_HW_PIN_PWM_ID &id, uint16_t var){ 
	(void)id; (void)var; 
  #if defined RT_HW_PERMIT_PIN_PWM
//-------------------------------------------------------------------------------------------------
//									40.0. Настройка пина (PWM)
//-------------------------------------------------------------------------------------------------
	if(id.dir==0){
		if(!checkPinPWM(id.pin)){id.dir=50; return;}		//--Проверка допустимости пина 	
		analogWriteResolution(getDepthPWM());				//--Установка разрядности PWM;		
		pinMode(id.pin, OUTPUT);							//--Инициализация дискретного вывода(PWM);												
		id.dir=1;
	} 
//-------------------------------------------------------------------------------------------------
//									40.1. Запись пина (PWM)
//-------------------------------------------------------------------------------------------------
	if(id.dir==1){
		id.cash=var;
		id.var=id.cash;
		id.vPin=normPWM(id.cash); 
		analogWrite(id.pin,id.vPin);
	}
//-------------------------------------------------------------------------------------------------
  #endif
//------------------------------------------------------------------------------------------------- 
  };	//--END pinPWM();
//=================================================================================================
//									41. PWM:: Широтно-импульсный вывод (для совместимости)
//=================================================================================================
  void  	pinPWM			(RT_HW_PIN_PWM_ID &id, uint8_t pin, uint16_t var){id.pin=pin; pinWritePWM(id, var);}; 

//=================================================================================================
//									42. FRQ:: Частотный выход[ESP32]
//=================================================================================================
  void 		pinWriteFreq	(RT_HW_PIN_PWM_ID &id, uint8_t var){ 
    (void)id; (void)var; 
  #if defined RT_HW_PERMIT_PIN_FRQ
//-------------------------------------------------------------------------------------------------
  #endif
//------------------------------------------------------------------------------------------------- 
  };	//--END pinFreq();
//=================================================================================================
//									43. FRQ:: Частотный выход[ESP32] (для совместимости)
//=================================================================================================
  void  	pinFreq			(RT_HW_PIN_PWM_ID &id, uint8_t pin, uint16_t var){id.pin=pin; pinWriteFreq(id, var);};

//=================================================================================================
//								  	44. SRV:: УПРАВЛЕНИЕ СЕРВО
//=================================================================================================
  void 		pinWriteServo	(RT_HW_PIN_SRV_ID &id, uint16_t var){
	(void)id; (void)var; 	
  #if defined RT_HW_PERMIT_PIN_SRV
//-------------------------------------------------------------------------------------------------
  #endif
//------------------------------------------------------------------------------------------------- 
  };	//--END pinServo()
//=================================================================================================
//									45. SRV:: УПРАВЛЕНИЕ СЕРВО (для совместимости)
//=================================================================================================
  void  	pinServo		(RT_HW_PIN_SRV_ID &id, uint8_t pin, uint16_t var){id.pin=pin; pinWriteServo(id, var);}; 

//=================================================================================================
//									50. TCH:: Сенсорный ввод [ESP32]
//=================================================================================================
  void pinTouchRead(RT_HW_PIN_TCH_ID &id, uint8_t pin){	
	(void)id; (void)pin;
  };

//=================================================================================================
//									52. HAL:: Чтение датчика Холла [ESP32]
//=================================================================================================
  void pinHallRead(RT_HW_PIN_HAL_ID &id){
	(void)id;
  };

//=================================================================================================
#endif
//=================================================================================================
