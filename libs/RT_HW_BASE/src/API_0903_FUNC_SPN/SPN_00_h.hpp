//#################################################################################################
//										API.h for SPN
//ecoins@mail.ru 26.04.2023г.
//=================================================================================================
/*

*/
//#################################################################################################

//=================================================================================================
#define RT_HW_LINK_SPN		//---FUNCTION CONNECTION DEFINER SPI
//+++++++++++++++++++++++++++++++++++++++++++++++++++++++++++++++++++++++++++++++++++++++++++++++++
//                          		3.INIT DEVICE
//+++++++++++++++++++++++++++++++++++++++++++++++++++++++++++++++++++++++++++++++++++++++++++++++++
//=================================================================================================
// 		    						3.1.Set parameters
//=================================================================================================
uint8_t spnSetParam(RT_HW_STRUCT_SPN_DEV &id, uint8_t sck, uint8_t miso, uint8_t mosi, uint8_t cs, uint8_t speed=0){
if(id.custom==0){id.link=id.status=id.codeErr=id.err=0; id.sck=sck; id.miso=miso; id.mosi=mosi; id.cs=cs; id.speed=speed; id.custom=1;} 
return id.custom;};
//=================================================================================================
//									3.2.spnInitDevice(id)
//=================================================================================================
void  spnInitDevice(RT_HW_STRUCT_SPN_DEV &id){ 
id.link=1;
if(id.custom==0){id.codeErr=50; return;} 
if(id.status==1){id.codeErr=0;  return;}
if(id.err==1)   {id.codeErr=51; return;}
id.status=id.codeErr=0;
//-------------------------------------------------------------------------------------------------
id.permitRX=id.permitTX=1;
//-------------------------------------------------------------------------------------------------
if(!checkPinPGM(RT_HW_PGM_PIN_DOT_ID,id.sck)) {id.codeErr=52; id.err=1; return;}	//--Error if pin number is not valid sck;
if(!checkPinPGM(RT_HW_PGM_PIN_DIN_ID,id.miso)){id.permitRX=0;}	
if(!checkPinPGM(RT_HW_PGM_PIN_DOT_ID,id.mosi)){id.permitTX=0;}
if(!checkPinPGM(RT_HW_PGM_PIN_DOT_ID,id.cs))  {id.codeErr=53; id.err=1; return;}	//--Error if pin number is not valid cs;
if(!id.permitRX && !id.permitTX)  			  {id.codeErr=54; id.err=1; return;}	
if(id.cs==id.sck)  			  				  {id.codeErr=55; id.err=1; return;}	
if(id.cs==id.miso)  			  			  {id.codeErr=56; id.err=1; return;}	
if(id.cs==id.mosi)  			  			  {id.codeErr=57; id.err=1; return;}
if(id.sck==id.miso)  			  			  {id.codeErr=58; id.err=1; return;}	
if(id.sck==id.mosi)  			  			  {id.codeErr=59; id.err=1; return;}
//-------------------------------------------------------------------------------------------------
if(id.speed>100){id.speed=100;} id.time=10-(id.speed/10);
//-------------------------------------------------------------------------------------------------
				digitalWrite(id.cs,1);   pinMode(id.cs,  OUTPUT);
				digitalWrite(id.sck,0);  pinMode(id.sck, OUTPUT);
if(id.permitTX){digitalWrite(id.mosi,1); pinMode(id.mosi,OUTPUT);}
if(id.permitRX){                         pinMode(id.miso,INPUT);}	
//-------------------------------------------------------------------------------------------------
id.custom=id.status=id.link=1;							//--Setting output parameters;
};
//+++++++++++++++++++++++++++++++++++++++++++++++++++++++++++++++++++++++++++++++++++++++++++++++++
//                          		4.Transfer(id)
//+++++++++++++++++++++++++++++++++++++++++++++++++++++++++++++++++++++++++++++++++++++++++++++++++
//=================================================================================================
//									4.1.spnTransferVar(tx,&rx)
//=================================================================================================
void  spnTransfer(RT_HW_STRUCT_SPN_DEV &id, uint32_t tx, uint32_t &rx, uint8_t qnt=1){				 
id.link=0; rx=0;
//-------------------------------------------------------------------------------------------------
if(id.qnt==0){id.link=1;    return;}		//--Exit for qnt=0;
if(qnt>4){qnt=4;} 							//--Limitation for qnt;
//-------------------------------------------------------------------------------------------------
for(id.idx=qnt-1; id.idx>=0; id.idx--){
//-------------------------------------------------------------------------------------------------
				digitalWrite(id.sck,0);		//--SCK  set to LOW;	
				digitalWrite(id.cs,0);		//--CS   set to LOW; 								
//-------------------------------------------------------------------------------------------------
for(id.idb=7; id.idb>=0; id.idb--){														//--Bit I/O;
//-------------------------------------------------------------------------------------------------
if(id.permitTX && id.userTX){   digitalWrite(id.mosi,(tx & (1<<(id.idb+(8*id.idx)))));}	//--Bit Output;
                                digitalWrite(id.sck,1); RT_HW_DELAY(id.time);			//--Strobe SCK;                              
//-------------------------------------------------------------------------------------------------
if(id.permitRX && id.userRX){if(digitalRead(id.miso)){rx |=(1<<(id.idb+(8*id.idx)));}}  //--Bit Input;
								digitalWrite(id.sck,0); RT_HW_DELAY(id.time);			//--Strobe SCK;
//-------------------------------------------------------------------------------------------------
}}																					
//-------------------------------------------------------------------------------------------------
				digitalWrite(id.cs,1);		//--SCK  set to LOW; 
				digitalWrite(id.sck,0);		//--CS   set to HIGH;;  
if(id.permitTX){digitalWrite(id.mosi,0);}	//--MOSI set to LOW;
id.link=1;};
//=================================================================================================
//									4.2.spnWrite
//=================================================================================================
void  spnWrite(RT_HW_STRUCT_SPN_DEV &id, uint32_t tx, uint8_t qnt=1){id.userTX=1; id.userRX=0; spnTransfer(id,tx,id.bf32,qnt);};
//=================================================================================================
//									4.3.spnRead(id)
//=================================================================================================
void  spnRead (RT_HW_STRUCT_SPN_DEV &id, uint8_t qnt=1){id.userTX=0; id.userRX=1; spnTransfer(id, 0,id.bf32,qnt);};
//=================================================================================================
//									4.4.spnReadReg(id) [Gag]
//=================================================================================================
void  spnREAD(RT_HW_STRUCT_SPN_DEV &id,  uint8_t reg){id.userTX=0; id.userRX=1; spnTransfer(id,(uint32_t)reg,id.bf32,1);};
//=================================================================================================
//									4.5.spnReadRegs(id) [Gag]
//=================================================================================================
void  spnREADArr(RT_HW_STRUCT_SPN_DEV &id, uint8_t reg, uint8_t *arr, uint8_t qnt=1){id.bf32=reg; id.idx=qnt;  arr[0]=id.link=1;};

//=================================================================================================
//									4.6.spiRead74HC165(id)
//=================================================================================================
void  spnRead74HC165(RT_HW_STRUCT_SPN_DEV &id, uint8_t qnt){
id.link=0; id.bf32=0;
//-------------------------------------------------------------------------------------------------
if(id.qnt==0){id.link=1;    return;}	//--Exit for qnt=0;
if(qnt>4){qnt=4;} 						//--Limitation for qnt;
//-------------------------------------------------------------------------------------------------
digitalWrite(id.cs,0);		//--CS   set to LOW;
delayMicroseconds(2);
digitalWrite(id.cs,1); 		//--CS   set to HIGH; 
for(id.idx=qnt-1; id.idx>=0; id.idx--){
//-------------------------------------------------------------------------------------------------
for(id.idb=7; id.idb>=0; id.idb--){														//--Bit I/O;
//-------------------------------------------------------------------------------------------------
if(id.permitRX && id.userRX){if(digitalRead(id.miso)){id.bf32 |=(1<<(id.idb+(8*id.idx)));}
                                digitalWrite(id.sck,1);  RT_HW_DELAY(id.time);	//--Strobe SCK
                                digitalWrite(id.sck,0);  RT_HW_DELAY(id.time);	//		with delay;
}   //--Bit Input;
//-------------------------------------------------------------------------------------------------
}}																					
//-------------------------------------------------------------------------------------------------
								digitalWrite(id.sck,0);		//--SCK  set to LOW; 
id.link=1;};
//=================================================================================================


//+++++++++++++++++++++++++++++++++++++++++++++++++++++++++++++++++++++++++++++++++++++++++++++++++
//                          		5.spiTransferArr(id) qnt byte
//+++++++++++++++++++++++++++++++++++++++++++++++++++++++++++++++++++++++++++++++++++++++++++++++++
//=================================================================================================
//									5.1.spnTransferVar(*arrTX,*arrRX,qnt)
//=================================================================================================
void  spnTransferArr(RT_HW_STRUCT_SPN_DEV &id, uint8_t *tx, uint8_t *rx, uint8_t qnt){				 
id.link=0; 
//-------------------------------------------------------------------------------------------------
if(id.qnt==0){id.link=1;    return;}			//--Exit for qnt=0;
digitalWrite(id.cs,1); digitalWrite(id.sck,0);	//--SCK set to LOW, CS set to HIGH;
//-------------------------------------------------------------------------------------------------
for(id.idx=qnt-1; id.idx>=0; id.idx--){
//-------------------------------------------------------------------------------------------------
								digitalWrite(id.cs,0);	//--SCK set to LOW, CS set to LOW; 										
//-------------------------------------------------------------------------------------------------
for(id.idb=7; id.idb>=0; id.idb--){															//--Bit I/O;
//-------------------------------------------------------------------------------------------------
if(id.permitTX && id.userTX){   digitalWrite(id.mosi,(tx[id.idx] & (1<<id.idb)));}	//--Bit Output;
//-------------------------------------------------------------------------------------------------
                                digitalWrite(id.sck,1); RT_HW_DELAY(id.time);		//--Strobe SCK;
//-------------------------------------------------------------------------------------------------
if(id.permitRX && id.userRX){if(digitalRead(id.miso)){rx[id.idx] |=(1<<(id.idb));}}	//--Bit Input;
								digitalWrite(id.sck,0); RT_HW_DELAY(id.time);		//--Strobe SCK;
//-------------------------------------------------------------------------------------------------
}								digitalWrite(id.cs,1);
//-------------------------------------------------------------------------------------------------
}																					
//-------------------------------------------------------------------------------------------------
				digitalWrite(id.cs,1); digitalWrite(id.sck,0);	//--CS   set to HIGH; SCK  set to LOW;  ; 
if(id.permitTX){digitalWrite(id.mosi,0);}	//--MOSI set to LOW;
id.link=1;};
//=================================================================================================
//									5.2.spnWriteArr(*arrTX,qnt)
//=================================================================================================
void  spnWriteArr(RT_HW_STRUCT_SPN_DEV &id, uint8_t *tx, uint8_t qnt){			 
id.link=0; 
//-------------------------------------------------------------------------------------------------
if(id.qnt==0){id.link=1;    return;}	//--Exit for qnt=0;
//-------------------------------------------------------------------------------------------------
for(id.idx=qnt-1; id.idx>=0; id.idx--){
//-------------------------------------------------------------------------------------------------
digitalWrite(id.sck,0); digitalWrite(id.cs,0);	//--SCK set to LOW, CS set to LOW;									
//-------------------------------------------------------------------------------------------------
for(id.idb=7; id.idb>=0; id.idb--){																//--Bit I/O;
//-------------------------------------------------------------------------------------------------
if(id.permitTX && id.userTX){   digitalWrite(id.mosi,(tx[id.idx] & (1<<id.idb)));}	//--Bit Output;
//-------------------------------------------------------------------------------------------------
                                digitalWrite(id.sck,1); RT_HW_DELAY(id.time);		//--Strobe SCK
                                digitalWrite(id.sck,0); RT_HW_DELAY(id.time);		//		with delay;
//-------------------------------------------------------------------------------------------------
}}																					
//-------------------------------------------------------------------------------------------------
				digitalWrite(id.cs,1); digitalWrite(id.sck,0);	//--CS   set to HIGH; SCK  set to LOW;  
if(id.permitTX){digitalWrite(id.mosi,0);}	//--MOSI set to LOW;
id.link=1;};
//=================================================================================================
//									5.3.spnRead(*arrRX,qnt)
//=================================================================================================
void  spnReadrArr(RT_HW_STRUCT_SPN_DEV &id, uint8_t *rx, uint8_t qnt){				 
id.link=0; 
//-------------------------------------------------------------------------------------------------
if(id.qnt==0){id.link=1;    return;}	//--Exit for qnt=0;
//-------------------------------------------------------------------------------------------------
for(id.idx=qnt-1; id.idx>=0; id.idx--){
//-------------------------------------------------------------------------------------------------
digitalWrite(id.sck,0); digitalWrite(id.cs,0);	//--SCK set to LOW, CS set to LOW;											
//-------------------------------------------------------------------------------------------------
for(id.idb=7; id.idb>=0; id.idb--){																//--Bit I/O;
//-------------------------------------------------------------------------------------------------
                                digitalWrite(id.sck,1); RT_HW_DELAY(id.time);		//--Strobe SCK;
//-------------------------------------------------------------------------------------------------
if(id.permitRX && id.userRX){if(digitalRead(id.miso)){rx[id.idx] |=(1<<(id.idb));}}	//--Bit Input; 
								digitalWrite(id.sck,0); RT_HW_DELAY(id.time);		//--Strobe SCK;
//-------------------------------------------------------------------------------------------------
};
}																					
//-------------------------------------------------------------------------------------------------
				digitalWrite(id.cs,1); digitalWrite(id.sck,0);	//--CS   set to HIGH; SCK  set to LOW;  
id.link=1;};
//=================================================================================================