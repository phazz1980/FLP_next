//+++++++++++++++++++++++++++++++++++++++++++++++++++++++++++++++++++++++++++++++++++++++++++++++++
//                         			ФУНКЦИИ ДЛЯ РАБОТЫ С УСТРОЙСТВАМИ UART
//+++++++++++++++++++++++++++++++++++++++++++++++++++++++++++++++++++++++++++++++++++++++++++++++++
//=================================================================================================
// 		    						4.1.1. Установка параметров комммуникации 
//								(default параметры: num=0; speed=RT_HW_UART_SPEED)
//=================================================================================================
  void     RT_HW_BASE:: 	uartSetParam(RT_HW_STRUCT_UART_DEV &id){
	if(id.custom==0){
		id.link=id.status=id.codeErr=0; 
		id.custom=1;
	}
  };
//=================================================================================================
// 		    						4.1.2. Установка параметров num,speed
//								(default параметры: num=0; speed=RT_HW_UART_SPEED)
//=================================================================================================
  void     RT_HW_BASE:: 	uartSetParam(RT_HW_STRUCT_UART_DEV &id, uint8_t num, uint32_t speed){
	if(id.custom==0){
		id.link=id.status=id.codeErr=0; 
		id.num=num; 
		id.speed=speed; 
		id.custom=1;}
  };
//=================================================================================================
// 		    						4.2. Инициализация устройства UART
//=================================================================================================
  void     RT_HW_BASE:: 	uartInitDevice(RT_HW_STRUCT_UART_DEV &id){
	id.codeErr=id.link=0;
	if(id.custom==0){id.codeErr=50;	id.link=1; return;} 
	if(id.status==1){				id.link=1; return;}
//------------------------------------------------------------------------------------------------
	if(!uartCheckNum(id.num))	 {id.codeErr=52; id.custom=2; 	return;}//--Проверка доступности номера UART;
	if(id.speed==0)				 {id.speed=RT_HW_UART_SPEED;}			//--Нормализация скорости;
	uartSetSpeed(id.speed,id.num);										//--Сохранение скорости;
//-------------------------------------------------------------------------------------------------
    if(!uartBegin(id.num))	     {				            	return;}//--Инициализация UART как Master;
    if( uartGetStatus(id.num)!=1){id.codeErr=54; id.custom=4; 	return;}//--Проверка      UART как Master;
//-------------------------------------------------------------------------------------------------
    id.custom=id.status=id.link=1;										//--Установка выходных параметров;
  };
//=================================================================================================
// 		    						4.3. Запись байта
//=================================================================================================
  uint8_t  	RT_HW_BASE:: 	uartWrite(RT_HW_STRUCT_UART_DEV &id, uint8_t var){
	id.link=0;
//-------------------------------------------------------------------------------------------------
	if(id.status!=1)		 {id.link=1; return 1;}	//--Выход, если UART не настроен;
  //if(uartSetBusy(id.num)==0) {         return 0;}	//--Захват UART;
	if(uartAvailableForWrite(id.num)==0){return 0;}	//--Ожидание освобождения выходного буфера UART;
//-------------------------------------------------------------------------------------------------
	id.codeErr=uartWrite(var,id.num); 				//--Запись байта;
	if(id.codeErr==0){id.link=0;} else {id.link=1;}
//-------------------------------------------------------------------------------------------------
  //uartClearBusy(id.num); 							//--Освобождение UART;	
//-------------------------------------------------------------------------------------------------
	return id.link;
  };
//=================================================================================================
// 		    						4.4. Запись байтового массива
//=================================================================================================
  void     RT_HW_BASE:: 	uartWriteArr(RT_HW_STRUCT_UART_DEV &id, uint8_t *arr, uint8_t qnt){
	id.link=0;
//-------------------------------------------------------------------------------------------------
	if(id.status!=1) {id.link=1; return;}			//--Выход, если UART не настроен;
  //if(uartSetBusy  (id.num)==0) {        return;};	//--Захват UART;
	if(uartAvailableForWrite(id.num)<qnt){return;}	//--Ожидание освобождения выходного буфера UART;
//-------------------------------------------------------------------------------------------------
	for(uint8_t i=0; i<qnt; i++){uartWrite(arr[i],id.num);} //--Write qnt bytes;
//-------------------------------------------------------------------------------------------------
  //uartClearBusy(id.num); 							//--Освобождение UART;		
//-------------------------------------------------------------------------------------------------
	id.link=1;
  };
//=================================================================================================